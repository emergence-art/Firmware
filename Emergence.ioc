# file: Emergence.ioc
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CORTEX_M7.CPU_DCache=Enabled
CORTEX_M7.CPU_ICache=Enabled
CORTEX_M7.PREFETCH_ENABLE=1
Dma.I2C1_RX.0.Direction=DMA_PERIPH_TO_MEMORY
Dma.I2C1_RX.0.FIFOMode=DMA_FIFOMODE_DISABLE
Dma.I2C1_RX.0.Instance=DMA1_Stream5
Dma.I2C1_RX.0.MemDataAlignment=DMA_MDATAALIGN_BYTE
Dma.I2C1_RX.0.MemInc=DMA_MINC_ENABLE
Dma.I2C1_RX.0.Mode=DMA_NORMAL
Dma.I2C1_RX.0.PeriphDataAlignment=DMA_PDATAALIGN_BYTE
Dma.I2C1_RX.0.PeriphInc=DMA_PINC_DISABLE
Dma.I2C1_RX.0.Priority=DMA_PRIORITY_LOW
Dma.I2C1_TX.1.Direction=DMA_MEMORY_TO_PERIPH
Dma.I2C1_TX.1.FIFOMode=DMA_FIFOMODE_DISABLE
Dma.I2C1_TX.1.Instance=DMA1_Stream6
Dma.I2C1_TX.1.MemDataAlignment=DMA_MDATAALIGN_BYTE
Dma.I2C1_TX.1.MemInc=DMA_MINC_ENABLE
Dma.I2C1_TX.1.Mode=DMA_NORMAL
Dma.I2C1_TX.1.PeriphDataAlignment=DMA_PDATAALIGN_BYTE
Dma.I2C1_TX.1.PeriphInc=DMA_PINC_DISABLE
Dma.I2C1_TX.1.Priority=DMA_PRIORITY_LOW
Dma.Request0=I2C1_RX
Dma.Request1=I2C1_TX
Dma.Request10=TIM8_CH3
Dma.Request11=TIM8_CH4/TRIG/COM
Dma.Request2=SPI2_RX
Dma.Request3=SPI2_TX
Dma.Request4=UART5_RX
Dma.Request5=UART5_TX
Dma.Request6=TIM1_CH1
Dma.Request7=TIM1_CH3
Dma.Request8=TIM8_CH1
Dma.Request9=TIM8_CH2
Dma.SPI2_RX.2.Direction=DMA_PERIPH_TO_MEMORY
Dma.SPI2_RX.2.FIFOMode=DMA_FIFOMODE_DISABLE
Dma.SPI2_RX.2.Instance=DMA1_Stream1
Dma.SPI2_RX.2.MemDataAlignment=DMA_MDATAALIGN_BYTE
Dma.SPI2_RX.2.MemInc=DMA_MINC_ENABLE
Dma.SPI2_RX.2.Mode=DMA_NORMAL
Dma.SPI2_RX.2.PeriphDataAlignment=DMA_PDATAALIGN_BYTE
Dma.SPI2_RX.2.PeriphInc=DMA_PINC_DISABLE
Dma.SPI2_RX.2.Priority=DMA_PRIORITY_LOW
Dma.SPI2_TX.3.Direction=DMA_MEMORY_TO_PERIPH
Dma.SPI2_TX.3.FIFOMode=DMA_FIFOMODE_DISABLE
Dma.SPI2_TX.3.Instance=DMA1_Stream4
Dma.SPI2_TX.3.MemDataAlignment=DMA_MDATAALIGN_BYTE
Dma.SPI2_TX.3.MemInc=DMA_MINC_ENABLE
Dma.SPI2_TX.3.Mode=DMA_NORMAL
Dma.SPI2_TX.3.PeriphDataAlignment=DMA_PDATAALIGN_BYTE
Dma.SPI2_TX.3.PeriphInc=DMA_PINC_DISABLE
Dma.SPI2_TX.3.Priority=DMA_PRIORITY_LOW
Dma.TIM1_CH1.6.Direction=DMA_MEMORY_TO_PERIPH
Dma.TIM1_CH1.6.FIFOMode=DMA_FIFOMODE_DISABLE
Dma.TIM1_CH1.6.Instance=DMA2_Stream1
Dma.TIM1_CH1.6.MemDataAlignment=DMA_MDATAALIGN_HALFWORD
Dma.TIM1_CH1.6.MemInc=DMA_MINC_ENABLE
Dma.TIM1_CH1.6.Mode=DMA_NORMAL
Dma.TIM1_CH1.6.PeriphDataAlignment=DMA_PDATAALIGN_HALFWORD
Dma.TIM1_CH1.6.PeriphInc=DMA_PINC_DISABLE
Dma.TIM1_CH1.6.Priority=DMA_PRIORITY_VERY_HIGH
Dma.TIM1_CH3.7.Direction=DMA_MEMORY_TO_PERIPH
Dma.TIM1_CH3.7.FIFOMode=DMA_FIFOMODE_DISABLE
Dma.TIM1_CH3.7.Instance=DMA2_Stream6
Dma.TIM1_CH3.7.MemDataAlignment=DMA_MDATAALIGN_HALFWORD
Dma.TIM1_CH3.7.MemInc=DMA_MINC_ENABLE
Dma.TIM1_CH3.7.Mode=DMA_NORMAL
Dma.TIM1_CH3.7.PeriphDataAlignment=DMA_PDATAALIGN_HALFWORD
Dma.TIM1_CH3.7.PeriphInc=DMA_PINC_DISABLE
Dma.TIM1_CH3.7.Priority=DMA_PRIORITY_VERY_HIGH
Dma.TIM8_CH1.8.Direction=DMA_MEMORY_TO_PERIPH
Dma.TIM8_CH1.8.FIFOMode=DMA_FIFOMODE_DISABLE
Dma.TIM8_CH1.8.Instance=DMA2_Stream2
Dma.TIM8_CH1.8.MemDataAlignment=DMA_MDATAALIGN_HALFWORD
Dma.TIM8_CH1.8.MemInc=DMA_MINC_ENABLE
Dma.TIM8_CH1.8.Mode=DMA_NORMAL
Dma.TIM8_CH1.8.PeriphDataAlignment=DMA_PDATAALIGN_HALFWORD
Dma.TIM8_CH1.8.PeriphInc=DMA_PINC_DISABLE
Dma.TIM8_CH1.8.Priority=DMA_PRIORITY_LOW
Dma.TIM8_CH2.9.Direction=DMA_MEMORY_TO_PERIPH
Dma.TIM8_CH2.9.FIFOMode=DMA_FIFOMODE_DISABLE
Dma.TIM8_CH2.9.Instance=DMA2_Stream3
Dma.TIM8_CH2.9.MemDataAlignment=DMA_MDATAALIGN_HALFWORD
Dma.TIM8_CH2.9.MemInc=DMA_MINC_ENABLE
Dma.TIM8_CH2.9.Mode=DMA_NORMAL
Dma.TIM8_CH2.9.PeriphDataAlignment=DMA_PDATAALIGN_HALFWORD
Dma.TIM8_CH2.9.PeriphInc=DMA_PINC_DISABLE
Dma.TIM8_CH2.9.Priority=DMA_PRIORITY_LOW
Dma.TIM8_CH3.10.Direction=DMA_MEMORY_TO_PERIPH
Dma.TIM8_CH3.10.FIFOMode=DMA_FIFOMODE_DISABLE
Dma.TIM8_CH3.10.Instance=DMA2_Stream4
Dma.TIM8_CH3.10.MemDataAlignment=DMA_MDATAALIGN_HALFWORD
Dma.TIM8_CH3.10.MemInc=DMA_MINC_ENABLE
Dma.TIM8_CH3.10.Mode=DMA_NORMAL
Dma.TIM8_CH3.10.PeriphDataAlignment=DMA_PDATAALIGN_HALFWORD
Dma.TIM8_CH3.10.PeriphInc=DMA_PINC_DISABLE
Dma.TIM8_CH3.10.Priority=DMA_PRIORITY_LOW
Dma.TIM8_CH4/TRIG/COM.11.Direction=DMA_MEMORY_TO_PERIPH
Dma.TIM8_CH4/TRIG/COM.11.FIFOMode=DMA_FIFOMODE_DISABLE
Dma.TIM8_CH4/TRIG/COM.11.Instance=DMA2_Stream7
Dma.TIM8_CH4/TRIG/COM.11.MemDataAlignment=DMA_MDATAALIGN_HALFWORD
Dma.TIM8_CH4/TRIG/COM.11.MemInc=DMA_MINC_ENABLE
Dma.TIM8_CH4/TRIG/COM.11.Mode=DMA_NORMAL
Dma.TIM8_CH4/TRIG/COM.11.PeriphDataAlignment=DMA_PDATAALIGN_HALFWORD
Dma.TIM8_CH4/TRIG/COM.11.PeriphInc=DMA_PINC_DISABLE
Dma.TIM8_CH4/TRIG/COM.11.Priority=DMA_PRIORITY_LOW
Dma.UART5_RX.4.Direction=DMA_PERIPH_TO_MEMORY
Dma.UART5_RX.4.FIFOMode=DMA_FIFOMODE_DISABLE
Dma.UART5_RX.4.Instance=DMA1_Stream0
Dma.UART5_RX.4.MemDataAlignment=DMA_MDATAALIGN_BYTE
Dma.UART5_RX.4.MemInc=DMA_MINC_ENABLE
Dma.UART5_RX.4.Mode=DMA_NORMAL
Dma.UART5_RX.4.PeriphDataAlignment=DMA_PDATAALIGN_BYTE
Dma.UART5_RX.4.PeriphInc=DMA_PINC_DISABLE
Dma.UART5_RX.4.Priority=DMA_PRIORITY_LOW
Dma.UART5_TX.5.Direction=DMA_MEMORY_TO_PERIPH
Dma.UART5_TX.5.FIFOMode=DMA_FIFOMODE_DISABLE
Dma.UART5_TX.5.Instance=DMA1_Stream7
Dma.UART5_TX.5.MemDataAlignment=DMA_MDATAALIGN_BYTE
Dma.UART5_TX.5.MemInc=DMA_MINC_ENABLE
Dma.UART5_TX.5.Mode=DMA_NORMAL
Dma.UART5_TX.5.PeriphDataAlignment=DMA_PDATAALIGN_BYTE
Dma.UART5_TX.5.PeriphInc=DMA_PINC_DISABLE
Dma.UART5_TX.5.Priority=DMA_PRIORITY_LOW
ETH.MACAddr=00\:00\:00\:00\:00\:00
ETH.MediaInterface=ETH_MEDIA_INTERFACE_RMII
ETH.PhyAddress=0
LWIP.CHECKSUM_BY_HARDWARE=1
LWIP.DHCP_DEBUG=LWIP_DBG_ON
LWIP.ICMP_DEBUG=LWIP_DBG_ON
LWIP.IP_DEBUG=LWIP_DBG_ON
LWIP.MEMP_NUM_UDP_PCB=5
LWIP.MEM_LIBC_MALLOC=1
LWIP.MEM_SIZE=8192
LWIP.PBUF_POOL_BUFSIZE=4152
LWIP.TCP_DEBUG=LWIP_DBG_ON
LWIP.TCP_MSS=1426
LWIP.UDP_DEBUG=LWIP_DBG_ON
LWIP.Version=v2.0.3_Cube
Mcu.Family=STM32F7
Mcu.Name=STM32F765B(G-I)Tx
Mcu.Package=LQFP208
NVIC.DMA1_Stream0_IRQn=true\:3\:0\:true\:false\:true\:false
NVIC.DMA1_Stream1_IRQn=true\:3\:0\:true\:false\:true\:false
NVIC.DMA1_Stream4_IRQn=true\:3\:0\:true\:false\:true\:false
NVIC.DMA1_Stream5_IRQn=true\:3\:0\:true\:false\:true\:false
NVIC.DMA1_Stream6_IRQn=true\:3\:0\:true\:false\:true\:false
NVIC.DMA1_Stream7_IRQn=true\:3\:0\:true\:false\:true\:false
NVIC.DMA2_Stream1_IRQn=true\:2\:0\:true\:false\:true\:false
NVIC.DMA2_Stream2_IRQn=true\:2\:0\:true\:false\:true\:false
NVIC.DMA2_Stream3_IRQn=true\:2\:0\:true\:false\:true\:false
NVIC.DMA2_Stream4_IRQn=true\:2\:0\:true\:false\:true\:false
NVIC.DMA2_Stream6_IRQn=true\:2\:0\:true\:false\:true\:false
NVIC.DMA2_Stream7_IRQn=true\:2\:0\:true\:false\:true\:false
NVIC.ETH_IRQn=true\:1\:0\:true\:false\:true\:true
NVIC.EXTI0_IRQn=true\:1\:0\:true\:false\:true\:true
NVIC.EXTI15_10_IRQn=true\:1\:0\:true\:false\:true\:true
NVIC.I2C1_ER_IRQn=true\:3\:0\:true\:false\:true\:true
NVIC.I2C1_EV_IRQn=true\:3\:0\:true\:false\:true\:true
NVIC.OTG_FS_IRQn=true\:1\:0\:true\:false\:true\:false
NVIC.PriorityGroup=NVIC_PRIORITYGROUP_4
NVIC.SPI2_IRQn=true\:3\:0\:true\:false\:true\:true
NVIC.TIM2_IRQn=true\:1\:0\:true\:false\:true\:true
NVIC.TIM5_IRQn=true\:1\:0\:true\:false\:true\:true
NVIC.UART5_IRQn=true\:3\:0\:true\:false\:true\:true
PA0/WKUP.GPIO_Label=SSYNC
PA0/WKUP.Signal=S_TIM2_CH1_ETR
PA1.GPIO_Label=ETH_REF_CLK
PA1.Mode=RMII
PA1.Signal=ETH_REF_CLK
PA10.GPIO_Label=USB_FS_ID
PA10.Signal=USB_OTG_FS_ID
PA11.GPIO_Label=USB_FS_DN
PA11.Mode=Device_Only
PA11.Signal=USB_OTG_FS_DM
PA12.GPIO_Label=USB_FS_DP
PA12.Mode=Device_Only
PA12.Signal=USB_OTG_FS_DP
PA13.Mode=JTAG_4_pins
PA13.Signal=SYS_JTMS-SWDIO
PA14.Mode=JTAG_4_pins
PA14.Signal=SYS_JTCK-SWCLK
PA15.Mode=JTAG_4_pins
PA15.Signal=SYS_JTDI
PA2.GPIO_Label=ETH_MDIO
PA2.Mode=RMII
PA2.Signal=ETH_MDIO
PA3.GPIO_Label=MSYNC
PA3.Signal=S_TIM5_CH4
PA4.GPIO_Label=DRV_VREF1
PA4.GPIO_Mode=GPIO_MODE_ANALOG
PA4.Signal=COMP_DAC1_group
PA5.GPIO_Label=DRV_VREF2
PA5.Signal=COMP_DAC2_group
PA7.GPIO_Label=ETH_CRS_DV
PA7.Mode=RMII
PA7.Signal=ETH_CRS_DV
PA8.GPIO_Label=USB_FS_SOF
PA8.Mode=Activate_SOF_FS
PA8.Signal=USB_OTG_FS_SOF
PA9.GPIO_Label=USB_FS_VBUS
PA9.Mode=Activate_VBUS
PA9.Signal=USB_OTG_FS_VBUS
PB0.GPIO_Label=BRD_LED1_G
PB0.GPIO_PuPd=GPIO_PULLDOWN
PB0.Signal=GPIO_Output
PB1.GPIO_Label=BRD_LED2_R
PB1.GPIO_PuPd=GPIO_PULLDOWN
PB1.Signal=GPIO_Output
PB10.GPIO_Label=SPI_SCK
PB10.Mode=Full_Duplex_Master
PB10.Signal=SPI2_SCK
PB11.GPIO_Label=ETH_TX_EN
PB11.GPIO_PuPd=GPIO_NOPULL
PB11.Mode=RMII
PB11.Signal=ETH_TX_EN
PB12.GPIO_Label=ETH_TXD0
PB12.GPIO_PuPd=GPIO_NOPULL
PB12.Mode=RMII
PB12.Signal=ETH_TXD0
PB13.GPIO_Label=ETH_TXD1
PB13.Mode=RMII
PB13.Signal=ETH_TXD1
PB14.GPIO_Label=BRD_LED1_R
PB14.GPIO_PuPd=GPIO_PULLDOWN
PB14.Signal=GPIO_Output
PB15.GPIO_Label=BRD_LED2_B
PB15.GPIO_PuPd=GPIO_PULLDOWN
PB15.Signal=GPIO_Output
PB2.GPIO_Label=BRD_LED2_G
PB2.GPIO_PuPd=GPIO_PULLDOWN
PB2.Signal=GPIO_Output
PB3.Mode=JTAG_4_pins
PB3.Signal=SYS_JTDO-SWO
PB4.GPIO_Label=SPI_NSS
PB4.Mode=NSS_Signal_Hard_Output
PB4.Signal=SPI2_NSS
PB5.GPIO_Label=UART_RX
PB5.Mode=Asynchronous
PB5.Signal=UART5_RX
PB6.GPIO_Label=UART_TX
PB6.Mode=Asynchronous
PB6.Signal=UART5_TX
PB7.GPIO_Label=BRD_LED1_B
PB7.GPIO_PuPd=GPIO_PULLDOWN
PB7.Signal=GPIO_Output
PB8.GPIO_Label=I2C_SCL
PB8.Mode=I2C
PB8.Signal=I2C1_SCL
PB9.GPIO_Label=I2C_SDA
PB9.Mode=I2C
PB9.Signal=I2C1_SDA
PC0.GPIO_Label=BRD_USER_BUTTON
PC0.GPIO_ModeDefaultEXTI=GPIO_MODE_IT_FALLING
PC0.Signal=GPXTI0
PC1.GPIO_Label=ETH_MDC
PC1.Mode=RMII
PC1.Signal=ETH_MDC
PC10.GPIO_Label=DRV_nFAULT_A
PC10.GPIO_ModeDefaultEXTI=GPIO_MODE_IT_FALLING
PC10.GPIO_PuPd=GPIO_PULLUP
PC10.Signal=GPXTI10
PC11.GPIO_Label=DRV_nFAULT_B
PC11.GPIO_ModeDefaultEXTI=GPIO_MODE_IT_FALLING
PC11.GPIO_PuPd=GPIO_PULLUP
PC11.Signal=GPXTI11
PC12.GPIO_Label=DRV_nFAULT_C
PC12.GPIO_ModeDefaultEXTI=GPIO_MODE_IT_FALLING
PC12.GPIO_PuPd=GPIO_PULLUP
PC12.Signal=GPXTI12
PC13.GPIO_Label=DRV_nFAULT_D
PC13.GPIO_ModeDefaultEXTI=GPIO_MODE_IT_FALLING
PC13.GPIO_PuPd=GPIO_PULLUP
PC13.Signal=GPXTI13
PC2.GPIO_Label=SPI_MISO
PC2.Mode=Full_Duplex_Master
PC2.Signal=SPI2_MISO
PC3.GPIO_Label=SPI_MOSI
PC3.Mode=Full_Duplex_Master
PC3.Signal=SPI2_MOSI
PC4.GPIO_Label=ETH_RXD0
PC4.Mode=RMII
PC4.Signal=ETH_RXD0
PC5.GPIO_Label=ETH_RXD1
PC5.Mode=RMII
PC5.Signal=ETH_RXD1
PC6.GPIO_Label=LED_nOE_A
PC6.GPIO_PuPd=GPIO_PULLUP
PC6.PinState=GPIO_PIN_SET
PC6.Signal=GPIO_Output
PC7.GPIO_Label=LED_nOE_B
PC7.GPIO_PuPd=GPIO_PULLUP
PC7.PinState=GPIO_PIN_SET
PC7.Signal=GPIO_Output
PC8.GPIO_Label=LED_nOE_C
PC8.GPIO_PuPd=GPIO_PULLUP
PC8.PinState=GPIO_PIN_SET
PC8.Signal=GPIO_Output
PC9.GPIO_Label=LED_nOE_D
PC9.GPIO_PuPd=GPIO_PULLUP
PC9.PinState=GPIO_PIN_SET
PC9.Signal=GPIO_Output
PD0.GPIO_Label=DRV_DIR_A_0
PD0.GPIO_Speed=GPIO_SPEED_FREQ_MEDIUM
PD0.Signal=GPIO_Output
PD1.GPIO_Label=DRV_STP_A_0
PD1.GPIO_Speed=GPIO_SPEED_FREQ_MEDIUM
PD1.Signal=GPIO_Output
PD10.GPIO_Label=DRV_DIR_A_5
PD10.GPIO_Speed=GPIO_SPEED_FREQ_MEDIUM
PD10.Signal=GPIO_Output
PD11.GPIO_Label=DRV_STP_A_5
PD11.GPIO_Speed=GPIO_SPEED_FREQ_MEDIUM
PD11.Signal=GPIO_Output
PD12.GPIO_Label=DRV_DIR_A_6
PD12.GPIO_Speed=GPIO_SPEED_FREQ_MEDIUM
PD12.Signal=GPIO_Output
PD13.GPIO_Label=DRV_STP_A_6
PD13.GPIO_Speed=GPIO_SPEED_FREQ_MEDIUM
PD13.Signal=GPIO_Output
PD14.GPIO_Label=DRV_DIR_A_7
PD14.GPIO_Speed=GPIO_SPEED_FREQ_MEDIUM
PD14.Signal=GPIO_Output
PD15.GPIO_Label=DRV_STP_A_7
PD15.GPIO_Speed=GPIO_SPEED_FREQ_MEDIUM
PD15.Signal=GPIO_Output
PD2.GPIO_Label=DRV_DIR_A_1
PD2.GPIO_Speed=GPIO_SPEED_FREQ_MEDIUM
PD2.Signal=GPIO_Output
PD3.GPIO_Label=DRV_STP_A_1
PD3.GPIO_Speed=GPIO_SPEED_FREQ_MEDIUM
PD3.Signal=GPIO_Output
PD4.GPIO_Label=DRV_DIR_A_2
PD4.GPIO_Speed=GPIO_SPEED_FREQ_MEDIUM
PD4.Signal=GPIO_Output
PD5.GPIO_Label=DRV_STP_A_2
PD5.GPIO_ModeDefaultOutputPP=GPIO_MODE_OUTPUT_PP
PD5.GPIO_PuPd=GPIO_NOPULL
PD5.GPIO_Speed=GPIO_SPEED_FREQ_MEDIUM
PD5.Signal=GPIO_Output
PD6.GPIO_Label=DRV_DIR_A_3
PD6.GPIO_Speed=GPIO_SPEED_FREQ_MEDIUM
PD6.Signal=GPIO_Output
PD7.GPIO_Label=DRV_STP_A_3
PD7.GPIO_Speed=GPIO_SPEED_FREQ_MEDIUM
PD7.Signal=GPIO_Output
PD8.GPIO_Label=DRV_DIR_A_4
PD8.GPIO_Speed=GPIO_SPEED_FREQ_MEDIUM
PD8.Signal=GPIO_Output
PD9.GPIO_Label=DRV_STP_A_4
PD9.GPIO_Speed=GPIO_SPEED_FREQ_MEDIUM
PD9.Signal=GPIO_Output
PE0.GPIO_Label=DRV_DIR_B_0
PE0.GPIO_Speed=GPIO_SPEED_FREQ_MEDIUM
PE0.Signal=GPIO_Output
PE1.GPIO_Label=DRV_STP_B_0
PE1.GPIO_Speed=GPIO_SPEED_FREQ_MEDIUM
PE1.Signal=GPIO_Output
PE10.GPIO_Label=DRV_DIR_B_5
PE10.GPIO_Speed=GPIO_SPEED_FREQ_MEDIUM
PE10.Signal=GPIO_Output
PE11.GPIO_Label=DRV_STP_B_5
PE11.GPIO_Speed=GPIO_SPEED_FREQ_MEDIUM
PE11.Signal=GPIO_Output
PE12.GPIO_Label=DRV_DIR_B_6
PE12.GPIO_Speed=GPIO_SPEED_FREQ_MEDIUM
PE12.Signal=GPIO_Output
PE13.GPIO_Label=DRV_STP_B_6
PE13.GPIO_Speed=GPIO_SPEED_FREQ_MEDIUM
PE13.Signal=GPIO_Output
PE14.GPIO_Label=DRV_DIR_B_7
PE14.GPIO_Speed=GPIO_SPEED_FREQ_MEDIUM
PE14.Signal=GPIO_Output
PE15.GPIO_Label=DRV_STP_B_7
PE15.GPIO_Speed=GPIO_SPEED_FREQ_MEDIUM
PE15.Signal=GPIO_Output
PE2.GPIO_Label=DRV_DIR_B_1
PE2.GPIO_Speed=GPIO_SPEED_FREQ_MEDIUM
PE2.Signal=GPIO_Output
PE3.GPIO_Label=DRV_STP_B_1
PE3.GPIO_Speed=GPIO_SPEED_FREQ_MEDIUM
PE3.Signal=GPIO_Output
PE4.GPIO_Label=DRV_DIR_B_2
PE4.GPIO_Speed=GPIO_SPEED_FREQ_MEDIUM
PE4.Signal=GPIO_Output
PE5.GPIO_Label=DRV_STP_B_2
PE5.GPIO_Speed=GPIO_SPEED_FREQ_MEDIUM
PE5.Signal=GPIO_Output
PE6.GPIO_Label=DRV_DIR_B_3
PE6.GPIO_Speed=GPIO_SPEED_FREQ_MEDIUM
PE6.Signal=GPIO_Output
PE7.GPIO_Label=DRV_STP_B_3
PE7.GPIO_Speed=GPIO_SPEED_FREQ_MEDIUM
PE7.Signal=GPIO_Output
PE8.GPIO_Label=DRV_DIR_B_4
PE8.GPIO_Speed=GPIO_SPEED_FREQ_MEDIUM
PE8.Signal=GPIO_Output
PE9.GPIO_Label=DRV_STP_B_4
PE9.GPIO_Speed=GPIO_SPEED_FREQ_MEDIUM
PE9.Signal=GPIO_Output
PF0.GPIO_Label=DRV_DIR_C_0
PF0.GPIO_Speed=GPIO_SPEED_FREQ_MEDIUM
PF0.Signal=GPIO_Output
PF1.GPIO_Label=DRV_STP_C_0
PF1.GPIO_Speed=GPIO_SPEED_FREQ_MEDIUM
PF1.Signal=GPIO_Output
PF10.GPIO_Label=DRV_DIR_C_5
PF10.GPIO_Speed=GPIO_SPEED_FREQ_MEDIUM
PF10.Signal=GPIO_Output
PF11.GPIO_Label=DRV_STP_C_5
PF11.GPIO_Speed=GPIO_SPEED_FREQ_MEDIUM
PF11.Signal=GPIO_Output
PF12.GPIO_Label=DRV_DIR_C_6
PF12.GPIO_Speed=GPIO_SPEED_FREQ_MEDIUM
PF12.Signal=GPIO_Output
PF13.GPIO_Label=DRV_STP_C_6
PF13.GPIO_Speed=GPIO_SPEED_FREQ_MEDIUM
PF13.Signal=GPIO_Output
PF14.GPIO_Label=DRV_DIR_C_7
PF14.GPIO_Speed=GPIO_SPEED_FREQ_MEDIUM
PF14.Signal=GPIO_Output
PF15.GPIO_Label=DRV_STP_C_7
PF15.GPIO_Speed=GPIO_SPEED_FREQ_MEDIUM
PF15.Signal=GPIO_Output
PF2.GPIO_Label=DRV_DIR_C_1
PF2.GPIO_Speed=GPIO_SPEED_FREQ_MEDIUM
PF2.Signal=GPIO_Output
PF3.GPIO_Label=DRV_STP_C_1
PF3.GPIO_Speed=GPIO_SPEED_FREQ_MEDIUM
PF3.Signal=GPIO_Output
PF4.GPIO_Label=DRV_DIR_C_2
PF4.GPIO_Speed=GPIO_SPEED_FREQ_MEDIUM
PF4.Signal=GPIO_Output
PF5.GPIO_Label=DRV_STP_C_2
PF5.GPIO_Speed=GPIO_SPEED_FREQ_MEDIUM
PF5.Signal=GPIO_Output
PF6.GPIO_Label=DRV_DIR_C_3
PF6.GPIO_Speed=GPIO_SPEED_FREQ_MEDIUM
PF6.Signal=GPIO_Output
PF7.GPIO_Label=DRV_STP_C_3
PF7.GPIO_Speed=GPIO_SPEED_FREQ_MEDIUM
PF7.Signal=GPIO_Output
PF8.GPIO_Label=DRV_DIR_C_4
PF8.GPIO_Speed=GPIO_SPEED_FREQ_MEDIUM
PF8.Signal=GPIO_Output
PF9.GPIO_Label=DRV_STP_C_4
PF9.GPIO_Speed=GPIO_SPEED_FREQ_MEDIUM
PF9.Signal=GPIO_Output
PG0.GPIO_Label=DRV_DIR_D_0
PG0.GPIO_Speed=GPIO_SPEED_FREQ_MEDIUM
PG0.Signal=GPIO_Output
PG1.GPIO_Label=DRV_STP_D_0
PG1.GPIO_Speed=GPIO_SPEED_FREQ_MEDIUM
PG1.Signal=GPIO_Output
PG10.GPIO_Label=DRV_DIR_D_5
PG10.GPIO_Speed=GPIO_SPEED_FREQ_MEDIUM
PG10.Signal=GPIO_Output
PG11.GPIO_Label=DRV_STP_D_5
PG11.GPIO_Speed=GPIO_SPEED_FREQ_MEDIUM
PG11.Signal=GPIO_Output
PG12.GPIO_Label=DRV_DIR_D_6
PG12.GPIO_Speed=GPIO_SPEED_FREQ_MEDIUM
PG12.Signal=GPIO_Output
PG13.GPIO_Label=DRV_STP_D_6
PG13.GPIO_Speed=GPIO_SPEED_FREQ_MEDIUM
PG13.Signal=GPIO_Output
PG14.GPIO_Label=DRV_DIR_D_7
PG14.GPIO_Speed=GPIO_SPEED_FREQ_MEDIUM
PG14.Signal=GPIO_Output
PG15.GPIO_Label=DRV_STP_D_7
PG15.GPIO_Speed=GPIO_SPEED_FREQ_MEDIUM
PG15.Signal=GPIO_Output
PG2.GPIO_Label=DRV_DIR_D_1
PG2.GPIO_Speed=GPIO_SPEED_FREQ_MEDIUM
PG2.Signal=GPIO_Output
PG3.GPIO_Label=DRV_STP_D_1
PG3.GPIO_Speed=GPIO_SPEED_FREQ_MEDIUM
PG3.Signal=GPIO_Output
PG4.GPIO_Label=DRV_DIR_D_2
PG4.GPIO_Speed=GPIO_SPEED_FREQ_MEDIUM
PG4.Signal=GPIO_Output
PG5.GPIO_Label=DRV_STP_D_2
PG5.GPIO_Speed=GPIO_SPEED_FREQ_MEDIUM
PG5.Signal=GPIO_Output
PG6.GPIO_Label=DRV_DIR_D_3
PG6.GPIO_Speed=GPIO_SPEED_FREQ_MEDIUM
PG6.Signal=GPIO_Output
PG7.GPIO_Label=DRV_STP_D_3
PG7.GPIO_Speed=GPIO_SPEED_FREQ_MEDIUM
PG7.Signal=GPIO_Output
PG8.GPIO_Label=DRV_DIR_D_4
PG8.GPIO_Speed=GPIO_SPEED_FREQ_MEDIUM
PG8.Signal=GPIO_Output
PG9.GPIO_Label=DRV_STP_D_4
PG9.GPIO_Speed=GPIO_SPEED_FREQ_MEDIUM
PG9.Signal=GPIO_Output
PH0/OSC_IN.GPIO_Label=RCC_OSC_IN
PH0/OSC_IN.Mode=HSE-External-Oscillator
PH0/OSC_IN.Signal=RCC_OSC_IN
PH1/OSC_OUT.GPIO_Label=RCC_OSC_OUT
PH1/OSC_OUT.Mode=HSE-External-Oscillator
PH1/OSC_OUT.Signal=RCC_OSC_OUT
PH10.GPIO_Label=DRV_nRESET_C
PH10.GPIO_PuPd=GPIO_PULLDOWN
PH10.Signal=GPIO_Output
PH11.GPIO_Label=DRV_nRESET_D
PH11.GPIO_PuPd=GPIO_PULLDOWN
PH11.Signal=GPIO_Output
PH12.GPIO_Label=DRV_nENBL_A
PH12.GPIO_PuPd=GPIO_PULLUP
PH12.PinState=GPIO_PIN_SET
PH12.Signal=GPIO_Output
PH13.GPIO_Label=DRV_nENBL_B
PH13.GPIO_PuPd=GPIO_PULLUP
PH13.PinState=GPIO_PIN_SET
PH13.Signal=GPIO_Output
PH14.GPIO_Label=DRV_nENBL_C
PH14.GPIO_PuPd=GPIO_PULLUP
PH14.PinState=GPIO_PIN_SET
PH14.Signal=GPIO_Output
PH15.GPIO_Label=DRV_nENBL_D
PH15.GPIO_PuPd=GPIO_PULLUP
PH15.GPIO_Speed=GPIO_SPEED_FREQ_LOW
PH15.PinState=GPIO_PIN_SET
PH15.Signal=GPIO_Output
PH2.GPIO_Label=DRV_MODE_0
PH2.GPIO_PuPd=GPIO_PULLUP
PH2.PinState=GPIO_PIN_SET
PH2.Signal=GPIO_Output
PH3.GPIO_Label=DRV_MODE_1
PH3.GPIO_PuPd=GPIO_PULLUP
PH3.PinState=GPIO_PIN_SET
PH3.Signal=GPIO_Output
PH4.GPIO_Label=DRV_MODE_2
PH4.GPIO_PuPd=GPIO_PULLUP
PH4.PinState=GPIO_PIN_SET
PH4.Signal=GPIO_Output
PH5.GPIO_Label=DRV_DECAY
PH5.Signal=GPIO_Output
PH8.GPIO_Label=DRV_nRESET_A
PH8.GPIO_PuPd=GPIO_PULLDOWN
PH8.Signal=GPIO_Output
PH9.GPIO_Label=DRV_nRESET_B
PH9.GPIO_PuPd=GPIO_PULLDOWN
PH9.Signal=GPIO_Output
PI0.GPIO_Label=LED_SDO_A_0
PI0.GPIO_Speed=GPIO_SPEED_FREQ_LOW
PI0.Signal=GPIO_Output
PI1.GPIO_Label=LED_SDO_A_1
PI1.GPIO_Speed=GPIO_SPEED_FREQ_LOW
PI1.Signal=GPIO_Output
PI10.GPIO_Label=LED_SDO_B_2
PI10.GPIO_Speed=GPIO_SPEED_FREQ_LOW
PI10.Signal=GPIO_Output
PI11.GPIO_Label=LED_SDO_B_3
PI11.GPIO_Speed=GPIO_SPEED_FREQ_LOW
PI11.Signal=GPIO_Output
PI12.GPIO_Label=LED_SDO_B_4
PI12.GPIO_Speed=GPIO_SPEED_FREQ_LOW
PI12.Signal=GPIO_Output
PI13.GPIO_Label=LED_SDO_B_5
PI13.GPIO_Speed=GPIO_SPEED_FREQ_LOW
PI13.Signal=GPIO_Output
PI14.GPIO_Label=LED_SDO_B_6
PI14.GPIO_Speed=GPIO_SPEED_FREQ_LOW
PI14.Signal=GPIO_Output
PI15.GPIO_Label=LED_SDO_B_7
PI15.GPIO_Speed=GPIO_SPEED_FREQ_LOW
PI15.Signal=GPIO_Output
PI2.GPIO_Label=LED_SDO_A_2
PI2.GPIO_Speed=GPIO_SPEED_FREQ_LOW
PI2.Signal=GPIO_Output
PI3.GPIO_Label=LED_SDO_A_3
PI3.GPIO_Speed=GPIO_SPEED_FREQ_LOW
PI3.Signal=GPIO_Output
PI4.GPIO_Label=LED_SDO_A_4
PI4.GPIO_Speed=GPIO_SPEED_FREQ_LOW
PI4.Signal=GPIO_Output
PI5.GPIO_Label=LED_SDO_A_5
PI5.GPIO_Speed=GPIO_SPEED_FREQ_LOW
PI5.Signal=GPIO_Output
PI6.GPIO_Label=LED_SDO_A_6
PI6.GPIO_Speed=GPIO_SPEED_FREQ_LOW
PI6.Signal=GPIO_Output
PI7.GPIO_Label=LED_SDO_A_7
PI7.GPIO_Speed=GPIO_SPEED_FREQ_LOW
PI7.Signal=GPIO_Output
PI8.GPIO_Label=LED_SDO_B_0*
PI8.GPIO_Speed=GPIO_SPEED_FREQ_LOW
PI8.Signal=GPIO_Output
PI9.GPIO_Label=LED_SDO_B_1
PI9.GPIO_Speed=GPIO_SPEED_FREQ_LOW
PI9.Signal=GPIO_Output
PJ0.GPIO_Label=LED_SDO_C_0
PJ0.GPIO_Speed=GPIO_SPEED_FREQ_LOW
PJ0.Signal=GPIO_Output
PJ1.GPIO_Label=LED_SDO_C_1
PJ1.GPIO_Speed=GPIO_SPEED_FREQ_LOW
PJ1.Signal=GPIO_Output
PJ10.GPIO_Label=LED_SDO_D_2
PJ10.GPIO_Speed=GPIO_SPEED_FREQ_LOW
PJ10.Signal=GPIO_Output
PJ11.GPIO_Label=LED_SDO_D_3
PJ11.GPIO_Speed=GPIO_SPEED_FREQ_LOW
PJ11.Signal=GPIO_Output
PJ12.GPIO_Label=LED_SDO_D_4
PJ12.GPIO_Speed=GPIO_SPEED_FREQ_LOW
PJ12.Signal=GPIO_Output
PJ13.GPIO_Label=LED_SDO_D_5
PJ13.GPIO_Speed=GPIO_SPEED_FREQ_LOW
PJ13.Signal=GPIO_Output
PJ14.GPIO_Label=LED_SDO_D_6
PJ14.GPIO_Speed=GPIO_SPEED_FREQ_LOW
PJ14.Signal=GPIO_Output
PJ15.GPIO_Label=LED_SDO_D_7
PJ15.GPIO_Speed=GPIO_SPEED_FREQ_LOW
PJ15.Signal=GPIO_Output
PJ2.GPIO_Label=LED_SDO_C_2
PJ2.GPIO_Speed=GPIO_SPEED_FREQ_LOW
PJ2.Signal=GPIO_Output
PJ3.GPIO_Label=LED_SDO_C_3
PJ3.GPIO_Speed=GPIO_SPEED_FREQ_LOW
PJ3.Signal=GPIO_Output
PJ4.GPIO_Label=LED_SDO_C_4
PJ4.GPIO_Speed=GPIO_SPEED_FREQ_LOW
PJ4.Signal=GPIO_Output
PJ5.GPIO_Label=LED_SDO_C_5
PJ5.GPIO_Speed=GPIO_SPEED_FREQ_LOW
PJ5.Signal=GPIO_Output
PJ6.GPIO_Label=LED_SDO_C_6
PJ6.GPIO_Speed=GPIO_SPEED_FREQ_LOW
PJ6.Signal=GPIO_Output
PJ7.GPIO_Label=LED_SDO_C_7
PJ7.GPIO_Speed=GPIO_SPEED_FREQ_LOW
PJ7.Signal=GPIO_Output
PJ8.GPIO_Label=LED_SDO_D_0
PJ8.GPIO_Speed=GPIO_SPEED_FREQ_LOW
PJ8.Signal=GPIO_Output
PJ9.GPIO_Label=LED_SDO_D_1
PJ9.GPIO_Speed=GPIO_SPEED_FREQ_LOW
PJ9.Signal=GPIO_Output
PK0.GPIO_Label=BRD_ID_0
PK0.GPIO_Mode=GPIO_MODE_INPUT
PK0.GPIO_PuPd=GPIO_PULLUP
PK0.Signal=GPIO_Input
PK1.GPIO_Label=BRD_ID_1
PK1.GPIO_Mode=GPIO_MODE_INPUT
PK1.GPIO_PuPd=GPIO_PULLUP
PK1.Signal=GPIO_Input
PK2.GPIO_Label=BRD_ID_2
PK2.GPIO_Mode=GPIO_MODE_INPUT
PK2.GPIO_PuPd=GPIO_PULLUP
PK2.Signal=GPIO_Input
PK3.GPIO_Label=BRD_ID_3
PK3.GPIO_Mode=GPIO_MODE_INPUT
PK3.GPIO_PuPd=GPIO_PULLUP
PK3.Signal=GPIO_Input
PK4.GPIO_Label=BRD_ID_4
PK4.GPIO_Mode=GPIO_MODE_INPUT
PK4.GPIO_PuPd=GPIO_PULLUP
PK4.Signal=GPIO_Input
PK5.GPIO_Label=BRD_ID_5
PK5.GPIO_Mode=GPIO_MODE_INPUT
PK5.GPIO_PuPd=GPIO_PULLUP
PK5.Signal=GPIO_Input
PK6.GPIO_Label=BRD_ID_6
PK6.GPIO_Mode=GPIO_MODE_INPUT
PK6.GPIO_PuPd=GPIO_PULLUP
PK6.Signal=GPIO_Input
PK7.GPIO_Label=BRD_ID_7
PK7.GPIO_Mode=GPIO_MODE_INPUT
PK7.GPIO_PuPd=GPIO_PULLUP
PK7.Signal=GPIO_Input
ProjectManager.HeapSize=0x200
ProjectManager.StackSize=0x400
ProjectManager.TargetToolchain=Makefile
RCC.AHBFreq_Value=200000000
RCC.APB1CLKDivider=RCC_HCLK_DIV4
RCC.APB1Freq_Value=50000000
RCC.APB1TimFreq_Value=100000000
RCC.APB2CLKDivider=RCC_HCLK_DIV2
RCC.APB2Freq_Value=100000000
RCC.APB2TimFreq_Value=200000000
RCC.CortexFreq_Value=200000000
RCC.HCLKFreq_Value=200000000
RCC.HSE_VALUE=8000000
RCC.HSI_VALUE=16000000
RCC.I2C1CLockSelection=RCC_I2C1CLKSOURCE_HSI
RCC.LSE_VALUE=32768
RCC.PLL48CLockSelection=RCC_CLK48SOURCE_PLLSAIP
RCC.PLLI2SN=100
RCC.PLLI2SR=4
RCC.PLLM=4
RCC.PLLN=200
RCC.PLLSAIN=96
RCC.PLLSAIP=RCC_PLLSAIP_DIV4
RCC.RCC_MCO2Source=RCC_MCO2SOURCE_PLLI2SCLK
RCC.RCC_MCODiv2=RCC_MCODIV_2
RCC.SYSCLKFreq_VALUE=200000000
RCC.SYSCLKSource=RCC_SYSCLKSOURCE_PLLCLK
RCC.UART5CLockSelection=RCC_UART5CLKSOURCE_HSI
RCC.USART1CLockSelection=RCC_USART1CLKSOURCE_HSI
RCC.USBFreq_Value=48000000
RCC.VCOOutputFreq_Value=400000000
SH.COMP_DAC1_group.0=DAC_OUT1,DAC_OUT1
SH.COMP_DAC2_group.0=DAC_OUT2,DAC_OUT2
SH.S_TIM2_CH1_ETR.0=TIM2_ETR,TriggerSource_ETR
SH.S_TIM5_CH4.0=TIM5_CH4,PWM Generation4 CH4
SPI2.BaudRatePrescaler=SPI_BAUDRATEPRESCALER_2
SPI2.CalculateBaudRate=25.0 MBits/s
SPI2.DataSize=SPI_DATASIZE_8BIT
SPI2.Direction=SPI_DIRECTION_2LINES
SPI2.Mode=SPI_MODE_MASTER
SPI2.VirtualNSS=VM_NSSHARD
SPI2.VirtualType=VM_MASTER
TIM1.Channel-Output\ Compare1\ No\ Output=TIM_CHANNEL_1
TIM1.Channel-Output\ Compare3\ No\ Output=TIM_CHANNEL_3
TIM1.Period=31
TIM1.Prescaler=1
TIM5.Channel-PWM\ Generation4\ CH4=TIM_CHANNEL_4
TIM8.Channel-Output\ Compare1\ No\ Output=TIM_CHANNEL_1
TIM8.Channel-Output\ Compare2\ No\ Output=TIM_CHANNEL_2
TIM8.Channel-Output\ Compare3\ No\ Output=TIM_CHANNEL_3
TIM8.Channel-Output\ Compare4\ No\ Output=TIM_CHANNEL_4
TIM8.Period=1
TIM8.Prescaler=1999
UART5.AutoBaudRateEnableParam=UART_ADVFEATURE_AUTOBAUDRATE_DISABLE
UART5.Mode=MODE_TX_RX
UART5.WordLength=WORDLENGTH_8B
USB_DEVICE.CLASS_NAME_FS=CDC
USB_DEVICE.MANUFACTURER_STRING-CDC_FS=Emergence
USB_DEVICE.PID_CDC_FS=0x5740
USB_DEVICE.PRODUCT_STRING_CDC_FS=Emergence VCP
USB_DEVICE.SERIALNUMBER_STRING_CDC_FS=000000000000
USB_DEVICE.USBD_DEBUG_LEVEL-CDC_FS=2
USB_DEVICE.VID-CDC_FS=0x0483
USB_DEVICE.VirtualMode-CDC_FS=Cdc
USB_DEVICE.VirtualModeFS=Cdc_FS
USB_OTG_FS.VirtualMode=Device_Only
VP_LWIP_VS_Enabled.Mode=Enabled
VP_TIM1_VS_ClockSourceINT.Mode=Internal
VP_TIM1_VS_no_output1.Mode=Output Compare1 No Output
VP_TIM1_VS_no_output3.Mode=Output Compare3 No Output
VP_TIM2_VS_ClockSourceINT.Mode=Internal
VP_TIM2_VS_ControllerModeTrigger.Mode=Trigger Mode
VP_TIM5_VS_ClockSourceINT.Mode=Internal
VP_TIM8_VS_ClockSourceINT.Mode=Internal
VP_TIM8_VS_no_output1.Mode=Output Compare1 No Output
VP_TIM8_VS_no_output2.Mode=Output Compare2 No Output
VP_TIM8_VS_no_output3.Mode=Output Compare3 No Output
VP_TIM8_VS_no_output4.Mode=Output Compare4 No Output
VP_USB_DEVICE_VS_USB_DEVICE_CDC_FS.Mode=CDC_FS
board=Emergence

// file: Src/main.c
/**
  ******************************************************************************
  * @file           : main.c
  * @brief          : Main program body
  ******************************************************************************
  * This notice applies to any and all portions of this file
  * that are not between comment pairs USER CODE BEGIN and
  * USER CODE END. Other portions of this file, whether
  * inserted by the user or by software development tools
  * are owned by their respective copyright owners.
  *
  * Copyright (c) 2018 STMicroelectronics International N.V.
  * All rights reserved.
  *
  * Redistribution and use in source and binary forms, with or without
  * modification, are permitted, provided that the following conditions are met:
  *
  * 1. Redistribution of source code must retain the above copyright notice,
  *    this list of conditions and the following disclaimer.
  * 2. Redistributions in binary form must reproduce the above copyright notice,
  *    this list of conditions and the following disclaimer in the documentation
  *    and/or other materials provided with the distribution.
  * 3. Neither the name of STMicroelectronics nor the names of other
  *    contributors to this software may be used to endorse or promote products
  *    derived from this software without specific written permission.
  * 4. This software, including modifications and/or derivative works of this
  *    software, must execute solely and exclusively on microcontroller or
  *    microprocessor devices manufactured by or for STMicroelectronics.
  * 5. Redistribution and use of this software other than as permitted under
  *    this license is void and will automatically terminate your rights under
  *    this license.
  *
  * THIS SOFTWARE IS PROVIDED BY STMICROELECTRONICS AND CONTRIBUTORS "AS IS"
  * AND ANY EXPRESS, IMPLIED OR STATUTORY WARRANTIES, INCLUDING, BUT NOT
  * LIMITED TO, THE IMPLIED WARRANTIES OF MERCHANTABILITY, FITNESS FOR A
  * PARTICULAR PURPOSE AND NON-INFRINGEMENT OF THIRD PARTY INTELLECTUAL PROPERTY
  * RIGHTS ARE DISCLAIMED TO THE FULLEST EXTENT PERMITTED BY LAW. IN NO EVENT
  * SHALL STMICROELECTRONICS OR CONTRIBUTORS BE LIABLE FOR ANY DIRECT, INDIRECT,
  * INCIDENTAL, SPECIAL, EXEMPLARY, OR CONSEQUENTIAL DAMAGES (INCLUDING, BUT NOT
  * LIMITED TO, PROCUREMENT OF SUBSTITUTE GOODS OR SERVICES; LOSS OF USE, DATA,
  * OR PROFITS; OR BUSINESS INTERRUPTION) HOWEVER CAUSED AND ON ANY THEORY OF
  * LIABILITY, WHETHER IN CONTRACT, STRICT LIABILITY, OR TORT (INCLUDING
  * NEGLIGENCE OR OTHERWISE) ARISING IN ANY WAY OUT OF THE USE OF THIS SOFTWARE,
  * EVEN IF ADVISED OF THE POSSIBILITY OF SUCH DAMAGE.
  *
  ******************************************************************************
  */
#include "main.h"
#include "stm32f7xx_hal.h"
#include "lwip.h"
#include "usb_device.h"

/* USER CODE BEGIN Includes */
#include "ex_leds.h"
#include "ex_motors.h"
#include "ex_servers.h"
/* USER CODE END Includes */

DAC_HandleTypeDef hdac;

I2C_HandleTypeDef hi2c1;
DMA_HandleTypeDef hdma_i2c1_rx;
DMA_HandleTypeDef hdma_i2c1_tx;

SPI_HandleTypeDef hspi2;
DMA_HandleTypeDef hdma_spi2_rx;
DMA_HandleTypeDef hdma_spi2_tx;

TIM_HandleTypeDef htim1;
TIM_HandleTypeDef htim2;
TIM_HandleTypeDef htim5;
TIM_HandleTypeDef htim8;
DMA_HandleTypeDef hdma_tim1_ch1;
DMA_HandleTypeDef hdma_tim1_ch3;
DMA_HandleTypeDef hdma_tim8_ch1;
DMA_HandleTypeDef hdma_tim8_ch2;
DMA_HandleTypeDef hdma_tim8_ch3;
DMA_HandleTypeDef hdma_tim8_ch4_trig_com;

UART_HandleTypeDef huart5;
DMA_HandleTypeDef hdma_uart5_rx;
DMA_HandleTypeDef hdma_uart5_tx;

/* From ethernetif.c */
extern uint8_t gMACAddr[6];
/* From lwip.c */
extern struct netif gnetif;

/* USER CODE BEGIN PV */
/* Private variables ---------------------------------------------------------*/
static const char Banner[] = "\n\
  ('-.  _   .-')       ('-.  _  .-')                 ('-.       .-') _             ('-.\n\
_(  OO)( '.( OO )_   _(  OO)( \\( -O )              _(  OO)     ( OO ) )          _(  OO)\n\
(,------.,--.   ,--.)(,------.,------.   ,----.    (,------.,--./ ,--,'  .-----. (,------.\n\
|  .---'|   `.'   |  |  .---'|   /`. ' '  .-./-')  |  .---'|   \\ |  |\\ '  .--./  |  .---'\n\
|  |    |         |  |  |    |  /  | | |  |_( O- ) |  |    |    \\|  | )|  |('-.  |  |\n\
(|  '--. |  |'.'|  | (|  '--. |  |_.' | |  | .--, \\(|  '--. |  .     |//_) |OO  )(|  '--.\n\
|  .--' |  |   |  |  |  .--' |  .  '.'(|  | '. (_/ |  .--' |  |\\    | ||  |`-'|  |  .--'\n\
|  `---.|  |   |  |  |  `---.|  |\\  \\  |  '--'  |  |  `---.|  | \\   |(_'  '--'\\  |  `---.\n\
`------'`--'   `--'  `------'`--' '--'  `------'   `------'`--'  `--'   `-----'  `------'\n\n";
/* USER CODE END PV */

void SystemClock_Config(void);
static void MX_GPIO_Init(void);
static void MX_DMA_Init(void);
static void MX_UART5_Init(void);
static void MX_I2C1_Init(void);
static void MX_SPI2_Init(void);
static void MX_DAC_Init(void);
static void MX_TIM1_Init(void);
static void MX_TIM8_Init(void);
static void MX_TIM2_Init(void);
static void MX_TIM5_Init(void);

void HAL_TIM_MspPostInit(TIM_HandleTypeDef *htim);

/* USER CODE BEGIN PFP */
/* Private function prototypes -----------------------------------------------*/

/* USER CODE END PFP */

/* USER CODE BEGIN 0 */
static void EX_Init(void)
{
  printf("%s", Banner);
  printf("Build: %s (%s) - %s, %s\n", VERSION, SHA1, __DATE__, __TIME__);
  ip4_addr_t *ip_addr = &gnetif.ip_addr;
  printf("IP: %u.%u.%u.%u (%02x:%02x:%02x:%02x:%02x:%02x)\n",
      ip4_addr1(ip_addr), ip4_addr2(ip_addr), ip4_addr3(ip_addr), ip4_addr4(ip_addr),
      gMACAddr[0], gMACAddr[1], gMACAddr[2], gMACAddr[3], gMACAddr[4], gMACAddr[5]);
}

void HAL_GPIO_EXTI_Callback(uint16_t GPIO_Pin)
{
  /* Check interrupt pin */
  switch (GPIO_Pin)
  {
    case BRD_USER_BUTTON_Pin:
      printf("EX: Emergency stop requested by user\n");
      break;
    case DRV_nFAULT_A_Pin:
      printf("EX: Fault detected with MOTOR's Bank A\n");
      break;
    case DRV_nFAULT_B_Pin:
      printf("EX: Fault detected with MOTOR's Bank B\n");
      break;
    case DRV_nFAULT_C_Pin:
      printf("EX: Fault detected with MOTOR's Bank C\n");
      break;
    case DRV_nFAULT_D_Pin:
      printf("EX: Fault detected with MOTOR's Bank D\n");
      break;
  }

  /* Disable motors and leds */
  EX_LEDS_Disable();
  EX_MOTORS_Disable();

  /* Notify operator */
  HAL_GPIO_WritePin(BRD_LED2_R_GPIO_Port, BRD_LED2_R_Pin, GPIO_PIN_SET);
}
/* USER CODE END 0 */

int main(void)
{

  /* Enable I-Cache-------------------------------------------------------------*/
  SCB_EnableICache();

  /* Enable D-Cache-------------------------------------------------------------*/
  SCB_EnableDCache();

  /* MCU Configuration----------------------------------------------------------*/

  /* Reset of all peripherals, Initializes the Flash interface and the Systick. */
  HAL_Init();

  /* Configure the system clock */
  SystemClock_Config();

  /* Initialize all configured peripherals */
  MX_GPIO_Init();
  MX_DMA_Init();
  MX_UART5_Init();
  MX_USB_DEVICE_Init();
  MX_I2C1_Init();
  MX_SPI2_Init();
  MX_DAC_Init();
  MX_LWIP_Init();
  MX_TIM1_Init();
  MX_TIM8_Init();
  MX_TIM2_Init();
  MX_TIM5_Init();
  /* USER CODE BEGIN 2 */
  EX_Init();
  EX_LEDS_Init();
  EX_MOTORS_Init();
  uint32_t *ptr = malloc(4096);
  UNUSED(ptr);
  EX_SERVERS_Init();
  EX_LEDS_Setup();
  EX_MOTORS_Setup();
  /* USER CODE END 2 */

  /* Infinite loop */
  /* USER CODE BEGIN WHILE */
  while (1)
  {
    /* Read a received packet and send it to the lwIP stack for handling */
    MX_LWIP_Process();
  /* USER CODE END WHILE */

  }

}

void SystemClock_Config(void)
{

  RCC_OscInitTypeDef RCC_OscInitStruct;
  RCC_ClkInitTypeDef RCC_ClkInitStruct;
  RCC_PeriphCLKInitTypeDef PeriphClkInitStruct;

    /**Configure the main internal regulator output voltage
    */
  __HAL_RCC_PWR_CLK_ENABLE();

  __HAL_PWR_VOLTAGESCALING_CONFIG(PWR_REGULATOR_VOLTAGE_SCALE1);

    /**Initializes the CPU, AHB and APB busses clocks
    */
  RCC_OscInitStruct.OscillatorType = RCC_OSCILLATORTYPE_HSI|RCC_OSCILLATORTYPE_HSE;
  RCC_OscInitStruct.HSEState = RCC_HSE_ON;
  RCC_OscInitStruct.HSIState = RCC_HSI_ON;
  RCC_OscInitStruct.HSICalibrationValue = 16;
  RCC_OscInitStruct.PLL.PLLState = RCC_PLL_ON;
  RCC_OscInitStruct.PLL.PLLSource = RCC_PLLSOURCE_HSE;
  RCC_OscInitStruct.PLL.PLLM = 4;
  RCC_OscInitStruct.PLL.PLLN = 200;
  RCC_OscInitStruct.PLL.PLLP = RCC_PLLP_DIV2;
  RCC_OscInitStruct.PLL.PLLQ = 2;
  if (HAL_RCC_OscConfig(&RCC_OscInitStruct) != HAL_OK)
  {
    _Error_Handler(__FILE__, __LINE__);
  }

    /**Activate the Over-Drive mode
    */
  if (HAL_PWREx_EnableOverDrive() != HAL_OK)
  {
    _Error_Handler(__FILE__, __LINE__);
  }

    /**Initializes the CPU, AHB and APB busses clocks
    */
  RCC_ClkInitStruct.ClockType = RCC_CLOCKTYPE_HCLK|RCC_CLOCKTYPE_SYSCLK
                              |RCC_CLOCKTYPE_PCLK1|RCC_CLOCKTYPE_PCLK2;
  RCC_ClkInitStruct.SYSCLKSource = RCC_SYSCLKSOURCE_PLLCLK;
  RCC_ClkInitStruct.AHBCLKDivider = RCC_SYSCLK_DIV1;
  RCC_ClkInitStruct.APB1CLKDivider = RCC_HCLK_DIV4;
  RCC_ClkInitStruct.APB2CLKDivider = RCC_HCLK_DIV2;

  if (HAL_RCC_ClockConfig(&RCC_ClkInitStruct, FLASH_LATENCY_6) != HAL_OK)
  {
    _Error_Handler(__FILE__, __LINE__);
  }

  PeriphClkInitStruct.PeriphClockSelection = RCC_PERIPHCLK_UART5|RCC_PERIPHCLK_I2C1
                              |RCC_PERIPHCLK_CLK48;
  PeriphClkInitStruct.PLLSAI.PLLSAIN = 96;
  PeriphClkInitStruct.PLLSAI.PLLSAIR = 2;
  PeriphClkInitStruct.PLLSAI.PLLSAIQ = 2;
  PeriphClkInitStruct.PLLSAI.PLLSAIP = RCC_PLLSAIP_DIV4;
  PeriphClkInitStruct.PLLSAIDivQ = 1;
  PeriphClkInitStruct.PLLSAIDivR = RCC_PLLSAIDIVR_2;
  PeriphClkInitStruct.Uart5ClockSelection = RCC_UART5CLKSOURCE_HSI;
  PeriphClkInitStruct.I2c1ClockSelection = RCC_I2C1CLKSOURCE_HSI;
  PeriphClkInitStruct.Clk48ClockSelection = RCC_CLK48SOURCE_PLLSAIP;
  if (HAL_RCCEx_PeriphCLKConfig(&PeriphClkInitStruct) != HAL_OK)
  {
    _Error_Handler(__FILE__, __LINE__);
  }

    /**Configure the Systick interrupt time
    */
  HAL_SYSTICK_Config(HAL_RCC_GetHCLKFreq()/1000);

    /**Configure the Systick
    */
  HAL_SYSTICK_CLKSourceConfig(SYSTICK_CLKSOURCE_HCLK);

  /* SysTick_IRQn interrupt configuration */
  HAL_NVIC_SetPriority(SysTick_IRQn, 0, 0);
}

/* DAC init function */
static void MX_DAC_Init(void)
{

  DAC_ChannelConfTypeDef sConfig;

    /**DAC Initialization
    */
  hdac.Instance = DAC;
  if (HAL_DAC_Init(&hdac) != HAL_OK)
  {
    _Error_Handler(__FILE__, __LINE__);
  }

    /**DAC channel OUT1 config
    */
  sConfig.DAC_Trigger = DAC_TRIGGER_NONE;
  sConfig.DAC_OutputBuffer = DAC_OUTPUTBUFFER_ENABLE;
  if (HAL_DAC_ConfigChannel(&hdac, &sConfig, DAC_CHANNEL_1) != HAL_OK)
  {
    _Error_Handler(__FILE__, __LINE__);
  }

    /**DAC channel OUT2 config
    */
  if (HAL_DAC_ConfigChannel(&hdac, &sConfig, DAC_CHANNEL_2) != HAL_OK)
  {
    _Error_Handler(__FILE__, __LINE__);
  }

}

/* I2C1 init function */
static void MX_I2C1_Init(void)
{

  hi2c1.Instance = I2C1;
  hi2c1.Init.Timing = 0x00303D5B;
  hi2c1.Init.OwnAddress1 = 0;
  hi2c1.Init.AddressingMode = I2C_ADDRESSINGMODE_7BIT;
  hi2c1.Init.DualAddressMode = I2C_DUALADDRESS_DISABLE;
  hi2c1.Init.OwnAddress2 = 0;
  hi2c1.Init.OwnAddress2Masks = I2C_OA2_NOMASK;
  hi2c1.Init.GeneralCallMode = I2C_GENERALCALL_DISABLE;
  hi2c1.Init.NoStretchMode = I2C_NOSTRETCH_DISABLE;
  if (HAL_I2C_Init(&hi2c1) != HAL_OK)
  {
    _Error_Handler(__FILE__, __LINE__);
  }

    /**Configure Analogue filter
    */
  if (HAL_I2CEx_ConfigAnalogFilter(&hi2c1, I2C_ANALOGFILTER_ENABLE) != HAL_OK)
  {
    _Error_Handler(__FILE__, __LINE__);
  }

    /**Configure Digital filter
    */
  if (HAL_I2CEx_ConfigDigitalFilter(&hi2c1, 0) != HAL_OK)
  {
    _Error_Handler(__FILE__, __LINE__);
  }

}

/* SPI2 init function */
static void MX_SPI2_Init(void)
{

  /* SPI2 parameter configuration*/
  hspi2.Instance = SPI2;
  hspi2.Init.Mode = SPI_MODE_MASTER;
  hspi2.Init.Direction = SPI_DIRECTION_2LINES;
  hspi2.Init.DataSize = SPI_DATASIZE_8BIT;
  hspi2.Init.CLKPolarity = SPI_POLARITY_LOW;
  hspi2.Init.CLKPhase = SPI_PHASE_1EDGE;
  hspi2.Init.NSS = SPI_NSS_HARD_OUTPUT;
  hspi2.Init.BaudRatePrescaler = SPI_BAUDRATEPRESCALER_2;
  hspi2.Init.FirstBit = SPI_FIRSTBIT_MSB;
  hspi2.Init.TIMode = SPI_TIMODE_DISABLE;
  hspi2.Init.CRCCalculation = SPI_CRCCALCULATION_DISABLE;
  hspi2.Init.CRCPolynomial = 7;
  hspi2.Init.CRCLength = SPI_CRC_LENGTH_DATASIZE;
  hspi2.Init.NSSPMode = SPI_NSS_PULSE_ENABLE;
  if (HAL_SPI_Init(&hspi2) != HAL_OK)
  {
    _Error_Handler(__FILE__, __LINE__);
  }

}

/* TIM1 init function */
static void MX_TIM1_Init(void)
{

  TIM_ClockConfigTypeDef sClockSourceConfig;
  TIM_MasterConfigTypeDef sMasterConfig;
  TIM_OC_InitTypeDef sConfigOC;
  TIM_BreakDeadTimeConfigTypeDef sBreakDeadTimeConfig;

  htim1.Instance = TIM1;
  htim1.Init.Prescaler = 1;
  htim1.Init.CounterMode = TIM_COUNTERMODE_UP;
  htim1.Init.Period = 31;
  htim1.Init.ClockDivision = TIM_CLOCKDIVISION_DIV1;
  htim1.Init.RepetitionCounter = 0;
  htim1.Init.AutoReloadPreload = TIM_AUTORELOAD_PRELOAD_DISABLE;
  if (HAL_TIM_Base_Init(&htim1) != HAL_OK)
  {
    _Error_Handler(__FILE__, __LINE__);
  }

  sClockSourceConfig.ClockSource = TIM_CLOCKSOURCE_INTERNAL;
  if (HAL_TIM_ConfigClockSource(&htim1, &sClockSourceConfig) != HAL_OK)
  {
    _Error_Handler(__FILE__, __LINE__);
  }

  if (HAL_TIM_OC_Init(&htim1) != HAL_OK)
  {
    _Error_Handler(__FILE__, __LINE__);
  }

  sMasterConfig.MasterOutputTrigger = TIM_TRGO_RESET;
  sMasterConfig.MasterOutputTrigger2 = TIM_TRGO2_RESET;
  sMasterConfig.MasterSlaveMode = TIM_MASTERSLAVEMODE_DISABLE;
  if (HAL_TIMEx_MasterConfigSynchronization(&htim1, &sMasterConfig) != HAL_OK)
  {
    _Error_Handler(__FILE__, __LINE__);
  }

  sConfigOC.OCMode = TIM_OCMODE_TIMING;
  sConfigOC.Pulse = 0;
  sConfigOC.OCPolarity = TIM_OCPOLARITY_HIGH;
  sConfigOC.OCNPolarity = TIM_OCNPOLARITY_HIGH;
  sConfigOC.OCFastMode = TIM_OCFAST_DISABLE;
  sConfigOC.OCIdleState = TIM_OCIDLESTATE_RESET;
  sConfigOC.OCNIdleState = TIM_OCNIDLESTATE_RESET;
  if (HAL_TIM_OC_ConfigChannel(&htim1, &sConfigOC, TIM_CHANNEL_1) != HAL_OK)
  {
    _Error_Handler(__FILE__, __LINE__);
  }

  if (HAL_TIM_OC_ConfigChannel(&htim1, &sConfigOC, TIM_CHANNEL_3) != HAL_OK)
  {
    _Error_Handler(__FILE__, __LINE__);
  }

  sBreakDeadTimeConfig.OffStateRunMode = TIM_OSSR_DISABLE;
  sBreakDeadTimeConfig.OffStateIDLEMode = TIM_OSSI_DISABLE;
  sBreakDeadTimeConfig.LockLevel = TIM_LOCKLEVEL_OFF;
  sBreakDeadTimeConfig.DeadTime = 0;
  sBreakDeadTimeConfig.BreakState = TIM_BREAK_DISABLE;
  sBreakDeadTimeConfig.BreakPolarity = TIM_BREAKPOLARITY_HIGH;
  sBreakDeadTimeConfig.BreakFilter = 0;
  sBreakDeadTimeConfig.Break2State = TIM_BREAK2_DISABLE;
  sBreakDeadTimeConfig.Break2Polarity = TIM_BREAK2POLARITY_HIGH;
  sBreakDeadTimeConfig.Break2Filter = 0;
  sBreakDeadTimeConfig.AutomaticOutput = TIM_AUTOMATICOUTPUT_DISABLE;
  if (HAL_TIMEx_ConfigBreakDeadTime(&htim1, &sBreakDeadTimeConfig) != HAL_OK)
  {
    _Error_Handler(__FILE__, __LINE__);
  }

}

/* TIM2 init function */
static void MX_TIM2_Init(void)
{

  TIM_ClockConfigTypeDef sClockSourceConfig;
  TIM_SlaveConfigTypeDef sSlaveConfig;
  TIM_MasterConfigTypeDef sMasterConfig;

  htim2.Instance = TIM2;
  htim2.Init.Prescaler = 0;
  htim2.Init.CounterMode = TIM_COUNTERMODE_UP;
  htim2.Init.Period = 0;
  htim2.Init.ClockDivision = TIM_CLOCKDIVISION_DIV1;
  htim2.Init.AutoReloadPreload = TIM_AUTORELOAD_PRELOAD_DISABLE;
  if (HAL_TIM_Base_Init(&htim2) != HAL_OK)
  {
    _Error_Handler(__FILE__, __LINE__);
  }

  sClockSourceConfig.ClockSource = TIM_CLOCKSOURCE_INTERNAL;
  if (HAL_TIM_ConfigClockSource(&htim2, &sClockSourceConfig) != HAL_OK)
  {
    _Error_Handler(__FILE__, __LINE__);
  }

  sSlaveConfig.SlaveMode = TIM_SLAVEMODE_TRIGGER;
  sSlaveConfig.InputTrigger = TIM_TS_ETRF;
  sSlaveConfig.TriggerPolarity = TIM_TRIGGERPOLARITY_NONINVERTED;
  sSlaveConfig.TriggerPrescaler = TIM_TRIGGERPRESCALER_DIV1;
  sSlaveConfig.TriggerFilter = 0;
  if (HAL_TIM_SlaveConfigSynchronization(&htim2, &sSlaveConfig) != HAL_OK)
  {
    _Error_Handler(__FILE__, __LINE__);
  }

  sMasterConfig.MasterOutputTrigger = TIM_TRGO_RESET;
  sMasterConfig.MasterSlaveMode = TIM_MASTERSLAVEMODE_DISABLE;
  if (HAL_TIMEx_MasterConfigSynchronization(&htim2, &sMasterConfig) != HAL_OK)
  {
    _Error_Handler(__FILE__, __LINE__);
  }

}

/* TIM5 init function */
static void MX_TIM5_Init(void)
{

  TIM_ClockConfigTypeDef sClockSourceConfig;
  TIM_MasterConfigTypeDef sMasterConfig;
  TIM_OC_InitTypeDef sConfigOC;

  htim5.Instance = TIM5;
  htim5.Init.Prescaler = 0;
  htim5.Init.CounterMode = TIM_COUNTERMODE_UP;
  htim5.Init.Period = 0;
  htim5.Init.ClockDivision = TIM_CLOCKDIVISION_DIV1;
  htim5.Init.AutoReloadPreload = TIM_AUTORELOAD_PRELOAD_DISABLE;
  if (HAL_TIM_Base_Init(&htim5) != HAL_OK)
  {
    _Error_Handler(__FILE__, __LINE__);
  }

  sClockSourceConfig.ClockSource = TIM_CLOCKSOURCE_INTERNAL;
  if (HAL_TIM_ConfigClockSource(&htim5, &sClockSourceConfig) != HAL_OK)
  {
    _Error_Handler(__FILE__, __LINE__);
  }

  if (HAL_TIM_PWM_Init(&htim5) != HAL_OK)
  {
    _Error_Handler(__FILE__, __LINE__);
  }

  sMasterConfig.MasterOutputTrigger = TIM_TRGO_RESET;
  sMasterConfig.MasterSlaveMode = TIM_MASTERSLAVEMODE_DISABLE;
  if (HAL_TIMEx_MasterConfigSynchronization(&htim5, &sMasterConfig) != HAL_OK)
  {
    _Error_Handler(__FILE__, __LINE__);
  }

  sConfigOC.OCMode = TIM_OCMODE_PWM1;
  sConfigOC.Pulse = 0;
  sConfigOC.OCPolarity = TIM_OCPOLARITY_HIGH;
  sConfigOC.OCFastMode = TIM_OCFAST_DISABLE;
  if (HAL_TIM_PWM_ConfigChannel(&htim5, &sConfigOC, TIM_CHANNEL_4) != HAL_OK)
  {
    _Error_Handler(__FILE__, __LINE__);
  }

  HAL_TIM_MspPostInit(&htim5);

}

/* TIM8 init function */
static void MX_TIM8_Init(void)
{

  TIM_ClockConfigTypeDef sClockSourceConfig;
  TIM_MasterConfigTypeDef sMasterConfig;
  TIM_OC_InitTypeDef sConfigOC;
  TIM_BreakDeadTimeConfigTypeDef sBreakDeadTimeConfig;

  htim8.Instance = TIM8;
  htim8.Init.Prescaler = 9999;
  htim8.Init.CounterMode = TIM_COUNTERMODE_UP;
  htim8.Init.Period = 1;
  htim8.Init.ClockDivision = TIM_CLOCKDIVISION_DIV1;
  htim8.Init.RepetitionCounter = 0;
  htim8.Init.AutoReloadPreload = TIM_AUTORELOAD_PRELOAD_DISABLE;
  if (HAL_TIM_Base_Init(&htim8) != HAL_OK)
  {
    _Error_Handler(__FILE__, __LINE__);
  }

  sClockSourceConfig.ClockSource = TIM_CLOCKSOURCE_INTERNAL;
  if (HAL_TIM_ConfigClockSource(&htim8, &sClockSourceConfig) != HAL_OK)
  {
    _Error_Handler(__FILE__, __LINE__);
  }

  if (HAL_TIM_OC_Init(&htim8) != HAL_OK)
  {
    _Error_Handler(__FILE__, __LINE__);
  }

  sMasterConfig.MasterOutputTrigger = TIM_TRGO_RESET;
  sMasterConfig.MasterOutputTrigger2 = TIM_TRGO2_RESET;
  sMasterConfig.MasterSlaveMode = TIM_MASTERSLAVEMODE_DISABLE;
  if (HAL_TIMEx_MasterConfigSynchronization(&htim8, &sMasterConfig) != HAL_OK)
  {
    _Error_Handler(__FILE__, __LINE__);
  }

  sConfigOC.OCMode = TIM_OCMODE_TIMING;
  sConfigOC.Pulse = 0;
  sConfigOC.OCPolarity = TIM_OCPOLARITY_HIGH;
  sConfigOC.OCNPolarity = TIM_OCNPOLARITY_HIGH;
  sConfigOC.OCFastMode = TIM_OCFAST_DISABLE;
  sConfigOC.OCIdleState = TIM_OCIDLESTATE_RESET;
  sConfigOC.OCNIdleState = TIM_OCNIDLESTATE_RESET;
  if (HAL_TIM_OC_ConfigChannel(&htim8, &sConfigOC, TIM_CHANNEL_1) != HAL_OK)
  {
    _Error_Handler(__FILE__, __LINE__);
  }

  if (HAL_TIM_OC_ConfigChannel(&htim8, &sConfigOC, TIM_CHANNEL_2) != HAL_OK)
  {
    _Error_Handler(__FILE__, __LINE__);
  }

  if (HAL_TIM_OC_ConfigChannel(&htim8, &sConfigOC, TIM_CHANNEL_3) != HAL_OK)
  {
    _Error_Handler(__FILE__, __LINE__);
  }

  if (HAL_TIM_OC_ConfigChannel(&htim8, &sConfigOC, TIM_CHANNEL_4) != HAL_OK)
  {
    _Error_Handler(__FILE__, __LINE__);
  }

  sBreakDeadTimeConfig.OffStateRunMode = TIM_OSSR_DISABLE;
  sBreakDeadTimeConfig.OffStateIDLEMode = TIM_OSSI_DISABLE;
  sBreakDeadTimeConfig.LockLevel = TIM_LOCKLEVEL_OFF;
  sBreakDeadTimeConfig.DeadTime = 0;
  sBreakDeadTimeConfig.BreakState = TIM_BREAK_DISABLE;
  sBreakDeadTimeConfig.BreakPolarity = TIM_BREAKPOLARITY_HIGH;
  sBreakDeadTimeConfig.BreakFilter = 0;
  sBreakDeadTimeConfig.Break2State = TIM_BREAK2_DISABLE;
  sBreakDeadTimeConfig.Break2Polarity = TIM_BREAK2POLARITY_HIGH;
  sBreakDeadTimeConfig.Break2Filter = 0;
  sBreakDeadTimeConfig.AutomaticOutput = TIM_AUTOMATICOUTPUT_DISABLE;
  if (HAL_TIMEx_ConfigBreakDeadTime(&htim8, &sBreakDeadTimeConfig) != HAL_OK)
  {
    _Error_Handler(__FILE__, __LINE__);
  }

}

/* UART5 init function */
static void MX_UART5_Init(void)
{

  huart5.Instance = UART5;
  huart5.Init.BaudRate = 115200;
  huart5.Init.WordLength = UART_WORDLENGTH_8B;
  huart5.Init.StopBits = UART_STOPBITS_1;
  huart5.Init.Parity = UART_PARITY_NONE;
  huart5.Init.Mode = UART_MODE_TX_RX;
  huart5.Init.HwFlowCtl = UART_HWCONTROL_NONE;
  huart5.Init.OverSampling = UART_OVERSAMPLING_16;
  huart5.Init.OneBitSampling = UART_ONE_BIT_SAMPLE_DISABLE;
  huart5.AdvancedInit.AdvFeatureInit = UART_ADVFEATURE_NO_INIT;
  if (HAL_UART_Init(&huart5) != HAL_OK)
  {
    _Error_Handler(__FILE__, __LINE__);
  }

}

static void MX_DMA_Init(void)
{
  /* DMA controller clock enable */
  __HAL_RCC_DMA1_CLK_ENABLE();
  __HAL_RCC_DMA2_CLK_ENABLE();

  /* DMA interrupt init */
  /* DMA1_Stream0_IRQn interrupt configuration */
  HAL_NVIC_SetPriority(DMA1_Stream0_IRQn, 3, 0);
  HAL_NVIC_EnableIRQ(DMA1_Stream0_IRQn);
  /* DMA1_Stream1_IRQn interrupt configuration */
  HAL_NVIC_SetPriority(DMA1_Stream1_IRQn, 3, 0);
  HAL_NVIC_EnableIRQ(DMA1_Stream1_IRQn);
  /* DMA1_Stream4_IRQn interrupt configuration */
  HAL_NVIC_SetPriority(DMA1_Stream4_IRQn, 3, 0);
  HAL_NVIC_EnableIRQ(DMA1_Stream4_IRQn);
  /* DMA1_Stream5_IRQn interrupt configuration */
  HAL_NVIC_SetPriority(DMA1_Stream5_IRQn, 3, 0);
  HAL_NVIC_EnableIRQ(DMA1_Stream5_IRQn);
  /* DMA1_Stream6_IRQn interrupt configuration */
  HAL_NVIC_SetPriority(DMA1_Stream6_IRQn, 3, 0);
  HAL_NVIC_EnableIRQ(DMA1_Stream6_IRQn);
  /* DMA1_Stream7_IRQn interrupt configuration */
  HAL_NVIC_SetPriority(DMA1_Stream7_IRQn, 3, 0);
  HAL_NVIC_EnableIRQ(DMA1_Stream7_IRQn);
  /* DMA2_Stream1_IRQn interrupt configuration */
  HAL_NVIC_SetPriority(DMA2_Stream1_IRQn, 2, 0);
  HAL_NVIC_EnableIRQ(DMA2_Stream1_IRQn);
  /* DMA2_Stream2_IRQn interrupt configuration */
  HAL_NVIC_SetPriority(DMA2_Stream2_IRQn, 2, 0);
  HAL_NVIC_EnableIRQ(DMA2_Stream2_IRQn);
  /* DMA2_Stream3_IRQn interrupt configuration */
  HAL_NVIC_SetPriority(DMA2_Stream3_IRQn, 2, 0);
  HAL_NVIC_EnableIRQ(DMA2_Stream3_IRQn);
  /* DMA2_Stream4_IRQn interrupt configuration */
  HAL_NVIC_SetPriority(DMA2_Stream4_IRQn, 2, 0);
  HAL_NVIC_EnableIRQ(DMA2_Stream4_IRQn);
  /* DMA2_Stream6_IRQn interrupt configuration */
  HAL_NVIC_SetPriority(DMA2_Stream6_IRQn, 2, 0);
  HAL_NVIC_EnableIRQ(DMA2_Stream6_IRQn);
  /* DMA2_Stream7_IRQn interrupt configuration */
  HAL_NVIC_SetPriority(DMA2_Stream7_IRQn, 2, 0);
  HAL_NVIC_EnableIRQ(DMA2_Stream7_IRQn);

}

/** Configure pins as
        * Analog
        * Input
        * Output
        * EVENT_OUT
        * EXTI
*/
static void MX_GPIO_Init(void)
{

  GPIO_InitTypeDef GPIO_InitStruct;

  /* GPIO Ports Clock Enable */
  __HAL_RCC_GPIOE_CLK_ENABLE();
  __HAL_RCC_GPIOI_CLK_ENABLE();
  __HAL_RCC_GPIOC_CLK_ENABLE();
  __HAL_RCC_GPIOF_CLK_ENABLE();
  __HAL_RCC_GPIOH_CLK_ENABLE();
  __HAL_RCC_GPIOA_CLK_ENABLE();
  __HAL_RCC_GPIOB_CLK_ENABLE();
  __HAL_RCC_GPIOJ_CLK_ENABLE();
  __HAL_RCC_GPIOG_CLK_ENABLE();
  __HAL_RCC_GPIOD_CLK_ENABLE();
  __HAL_RCC_GPIOK_CLK_ENABLE();

  /*Configure GPIO pin Output Level */
  HAL_GPIO_WritePin(GPIOE, DRV_DIR_B_1_Pin|DRV_STP_B_1_Pin|DRV_DIR_B_2_Pin|DRV_STP_B_2_Pin
                          |DRV_DIR_B_3_Pin|DRV_STP_B_3_Pin|DRV_DIR_B_4_Pin|DRV_STP_B_4_Pin
                          |DRV_DIR_B_5_Pin|DRV_STP_B_5_Pin|DRV_DIR_B_6_Pin|DRV_STP_B_6_Pin
                          |DRV_DIR_B_7_Pin|DRV_STP_B_7_Pin|DRV_DIR_B_0_Pin|DRV_STP_B_0_Pin, GPIO_PIN_RESET);

  /*Configure GPIO pin Output Level */
  HAL_GPIO_WritePin(GPIOI, LED_SDO_B_0__Pin|LED_SDO_B_1_Pin|LED_SDO_B_2_Pin|LED_SDO_B_3_Pin
                          |LED_SDO_B_4_Pin|LED_SDO_B_5_Pin|LED_SDO_B_6_Pin|LED_SDO_B_7_Pin
                          |LED_SDO_A_0_Pin|LED_SDO_A_1_Pin|LED_SDO_A_2_Pin|LED_SDO_A_3_Pin
                          |LED_SDO_A_4_Pin|LED_SDO_A_5_Pin|LED_SDO_A_6_Pin|LED_SDO_A_7_Pin, GPIO_PIN_RESET);

  /*Configure GPIO pin Output Level */
  HAL_GPIO_WritePin(GPIOF, DRV_DIR_C_0_Pin|DRV_STP_C_0_Pin|DRV_DIR_C_1_Pin|DRV_STP_C_1_Pin
                          |DRV_DIR_C_2_Pin|DRV_STP_C_2_Pin|DRV_DIR_C_3_Pin|DRV_STP_C_3_Pin
                          |DRV_DIR_C_4_Pin|DRV_STP_C_4_Pin|DRV_DIR_C_5_Pin|DRV_STP_C_5_Pin
                          |DRV_DIR_C_6_Pin|DRV_STP_C_6_Pin|DRV_DIR_C_7_Pin|DRV_STP_C_7_Pin, GPIO_PIN_RESET);

  /*Configure GPIO pin Output Level */
  HAL_GPIO_WritePin(GPIOH, DRV_MODE_0_Pin|DRV_MODE_1_Pin|DRV_MODE_2_Pin|DRV_nENBL_A_Pin
                          |DRV_nENBL_B_Pin|DRV_nENBL_C_Pin|DRV_nENBL_D_Pin, GPIO_PIN_SET);

  /*Configure GPIO pin Output Level */
  HAL_GPIO_WritePin(GPIOH, DRV_DECAY_Pin|DRV_nRESET_A_Pin|DRV_nRESET_B_Pin|DRV_nRESET_C_Pin
                          |DRV_nRESET_D_Pin, GPIO_PIN_RESET);

  /*Configure GPIO pin Output Level */
  HAL_GPIO_WritePin(GPIOB, BRD_LED1_G_Pin|BRD_LED2_R_Pin|BRD_LED2_G_Pin|BRD_LED1_R_Pin
                          |BRD_LED2_B_Pin|BRD_LED1_B_Pin, GPIO_PIN_RESET);

  /*Configure GPIO pin Output Level */
  HAL_GPIO_WritePin(GPIOJ, LED_SDO_C_0_Pin|LED_SDO_C_1_Pin|LED_SDO_C_2_Pin|LED_SDO_C_3_Pin
                          |LED_SDO_C_4_Pin|LED_SDO_C_5_Pin|LED_SDO_C_6_Pin|LED_SDO_C_7_Pin
                          |LED_SDO_D_0_Pin|LED_SDO_D_1_Pin|LED_SDO_D_2_Pin|LED_SDO_D_3_Pin
                          |LED_SDO_D_4_Pin|LED_SDO_D_5_Pin|LED_SDO_D_6_Pin|LED_SDO_D_7_Pin, GPIO_PIN_RESET);

  /*Configure GPIO pin Output Level */
  HAL_GPIO_WritePin(GPIOG, DRV_DIR_D_0_Pin|DRV_STP_D_0_Pin|DRV_DIR_D_1_Pin|DRV_STP_D_1_Pin
                          |DRV_DIR_D_2_Pin|DRV_STP_D_2_Pin|DRV_DIR_D_3_Pin|DRV_STP_D_3_Pin
                          |DRV_DIR_D_4_Pin|DRV_STP_D_4_Pin|DRV_DIR_D_5_Pin|DRV_STP_D_5_Pin
                          |DRV_DIR_D_6_Pin|DRV_STP_D_6_Pin|DRV_DIR_D_7_Pin|DRV_STP_D_7_Pin, GPIO_PIN_RESET);

  /*Configure GPIO pin Output Level */
  HAL_GPIO_WritePin(GPIOD, DRV_DIR_A_4_Pin|DRV_STP_A_4_Pin|DRV_DIR_A_5_Pin|DRV_STP_A_5_Pin
                          |DRV_DIR_A_6_Pin|DRV_STP_A_6_Pin|DRV_DIR_A_7_Pin|DRV_STP_A_7_Pin
                          |DRV_DIR_A_0_Pin|DRV_STP_A_0_Pin|DRV_DIR_A_1_Pin|DRV_STP_A_1_Pin
                          |DRV_DIR_A_2_Pin|DRV_STP_A_2_Pin|DRV_DIR_A_3_Pin|DRV_STP_A_3_Pin, GPIO_PIN_RESET);

  /*Configure GPIO pin Output Level */
  HAL_GPIO_WritePin(GPIOC, LED_nOE_A_Pin|LED_nOE_B_Pin|LED_nOE_C_Pin|LED_nOE_D_Pin, GPIO_PIN_SET);

  /*Configure GPIO pins : DRV_DIR_B_1_Pin DRV_STP_B_1_Pin DRV_DIR_B_2_Pin DRV_STP_B_2_Pin
                           DRV_DIR_B_3_Pin DRV_STP_B_3_Pin DRV_DIR_B_4_Pin DRV_STP_B_4_Pin
                           DRV_DIR_B_5_Pin DRV_STP_B_5_Pin DRV_DIR_B_6_Pin DRV_STP_B_6_Pin
                           DRV_DIR_B_7_Pin DRV_STP_B_7_Pin DRV_DIR_B_0_Pin DRV_STP_B_0_Pin */
  GPIO_InitStruct.Pin = DRV_DIR_B_1_Pin|DRV_STP_B_1_Pin|DRV_DIR_B_2_Pin|DRV_STP_B_2_Pin
                          |DRV_DIR_B_3_Pin|DRV_STP_B_3_Pin|DRV_DIR_B_4_Pin|DRV_STP_B_4_Pin
                          |DRV_DIR_B_5_Pin|DRV_STP_B_5_Pin|DRV_DIR_B_6_Pin|DRV_STP_B_6_Pin
                          |DRV_DIR_B_7_Pin|DRV_STP_B_7_Pin|DRV_DIR_B_0_Pin|DRV_STP_B_0_Pin;
  GPIO_InitStruct.Mode = GPIO_MODE_OUTPUT_PP;
  GPIO_InitStruct.Pull = GPIO_NOPULL;
  GPIO_InitStruct.Speed = GPIO_SPEED_FREQ_MEDIUM;
  HAL_GPIO_Init(GPIOE, &GPIO_InitStruct);

  /*Configure GPIO pins : LED_SDO_B_0__Pin LED_SDO_B_1_Pin LED_SDO_B_2_Pin LED_SDO_B_3_Pin
                           LED_SDO_B_4_Pin LED_SDO_B_5_Pin LED_SDO_B_6_Pin LED_SDO_B_7_Pin
                           LED_SDO_A_0_Pin LED_SDO_A_1_Pin LED_SDO_A_2_Pin LED_SDO_A_3_Pin
                           LED_SDO_A_4_Pin LED_SDO_A_5_Pin LED_SDO_A_6_Pin LED_SDO_A_7_Pin */
  GPIO_InitStruct.Pin = LED_SDO_B_0__Pin|LED_SDO_B_1_Pin|LED_SDO_B_2_Pin|LED_SDO_B_3_Pin
                          |LED_SDO_B_4_Pin|LED_SDO_B_5_Pin|LED_SDO_B_6_Pin|LED_SDO_B_7_Pin
                          |LED_SDO_A_0_Pin|LED_SDO_A_1_Pin|LED_SDO_A_2_Pin|LED_SDO_A_3_Pin
                          |LED_SDO_A_4_Pin|LED_SDO_A_5_Pin|LED_SDO_A_6_Pin|LED_SDO_A_7_Pin;
  GPIO_InitStruct.Mode = GPIO_MODE_OUTPUT_PP;
  GPIO_InitStruct.Pull = GPIO_NOPULL;
  GPIO_InitStruct.Speed = GPIO_SPEED_FREQ_LOW;
  HAL_GPIO_Init(GPIOI, &GPIO_InitStruct);

  /*Configure GPIO pins : DRV_nFAULT_D_Pin DRV_nFAULT_A_Pin DRV_nFAULT_B_Pin DRV_nFAULT_C_Pin */
  GPIO_InitStruct.Pin = DRV_nFAULT_D_Pin|DRV_nFAULT_A_Pin|DRV_nFAULT_B_Pin|DRV_nFAULT_C_Pin;
  GPIO_InitStruct.Mode = GPIO_MODE_IT_FALLING;
  GPIO_InitStruct.Pull = GPIO_PULLUP;
  HAL_GPIO_Init(GPIOC, &GPIO_InitStruct);

  /*Configure GPIO pins : DRV_DIR_C_0_Pin DRV_STP_C_0_Pin DRV_DIR_C_1_Pin DRV_STP_C_1_Pin
                           DRV_DIR_C_2_Pin DRV_STP_C_2_Pin DRV_DIR_C_3_Pin DRV_STP_C_3_Pin
                           DRV_DIR_C_4_Pin DRV_STP_C_4_Pin DRV_DIR_C_5_Pin DRV_STP_C_5_Pin
                           DRV_DIR_C_6_Pin DRV_STP_C_6_Pin DRV_DIR_C_7_Pin DRV_STP_C_7_Pin */
  GPIO_InitStruct.Pin = DRV_DIR_C_0_Pin|DRV_STP_C_0_Pin|DRV_DIR_C_1_Pin|DRV_STP_C_1_Pin
                          |DRV_DIR_C_2_Pin|DRV_STP_C_2_Pin|DRV_DIR_C_3_Pin|DRV_STP_C_3_Pin
                          |DRV_DIR_C_4_Pin|DRV_STP_C_4_Pin|DRV_DIR_C_5_Pin|DRV_STP_C_5_Pin
                          |DRV_DIR_C_6_Pin|DRV_STP_C_6_Pin|DRV_DIR_C_7_Pin|DRV_STP_C_7_Pin;
  GPIO_InitStruct.Mode = GPIO_MODE_OUTPUT_PP;
  GPIO_InitStruct.Pull = GPIO_NOPULL;
  GPIO_InitStruct.Speed = GPIO_SPEED_FREQ_MEDIUM;
  HAL_GPIO_Init(GPIOF, &GPIO_InitStruct);

  /*Configure GPIO pin : BRD_USER_BUTTON_Pin */
  GPIO_InitStruct.Pin = BRD_USER_BUTTON_Pin;
  GPIO_InitStruct.Mode = GPIO_MODE_IT_FALLING;
  GPIO_InitStruct.Pull = GPIO_NOPULL;
  HAL_GPIO_Init(BRD_USER_BUTTON_GPIO_Port, &GPIO_InitStruct);

  /*Configure GPIO pins : DRV_MODE_0_Pin DRV_MODE_1_Pin DRV_MODE_2_Pin DRV_nENBL_A_Pin
                           DRV_nENBL_B_Pin DRV_nENBL_C_Pin DRV_nENBL_D_Pin */
  GPIO_InitStruct.Pin = DRV_MODE_0_Pin|DRV_MODE_1_Pin|DRV_MODE_2_Pin|DRV_nENBL_A_Pin
                          |DRV_nENBL_B_Pin|DRV_nENBL_C_Pin|DRV_nENBL_D_Pin;
  GPIO_InitStruct.Mode = GPIO_MODE_OUTPUT_PP;
  GPIO_InitStruct.Pull = GPIO_PULLUP;
  GPIO_InitStruct.Speed = GPIO_SPEED_FREQ_LOW;
  HAL_GPIO_Init(GPIOH, &GPIO_InitStruct);

  /*Configure GPIO pin : DRV_DECAY_Pin */
  GPIO_InitStruct.Pin = DRV_DECAY_Pin;
  GPIO_InitStruct.Mode = GPIO_MODE_OUTPUT_PP;
  GPIO_InitStruct.Pull = GPIO_NOPULL;
  GPIO_InitStruct.Speed = GPIO_SPEED_FREQ_LOW;
  HAL_GPIO_Init(DRV_DECAY_GPIO_Port, &GPIO_InitStruct);

  /*Configure GPIO pins : BRD_LED1_G_Pin BRD_LED2_R_Pin BRD_LED2_G_Pin BRD_LED1_R_Pin
                           BRD_LED2_B_Pin BRD_LED1_B_Pin */
  GPIO_InitStruct.Pin = BRD_LED1_G_Pin|BRD_LED2_R_Pin|BRD_LED2_G_Pin|BRD_LED1_R_Pin
                          |BRD_LED2_B_Pin|BRD_LED1_B_Pin;
  GPIO_InitStruct.Mode = GPIO_MODE_OUTPUT_PP;
  GPIO_InitStruct.Pull = GPIO_PULLDOWN;
  GPIO_InitStruct.Speed = GPIO_SPEED_FREQ_LOW;
  HAL_GPIO_Init(GPIOB, &GPIO_InitStruct);

  /*Configure GPIO pins : LED_SDO_C_0_Pin LED_SDO_C_1_Pin LED_SDO_C_2_Pin LED_SDO_C_3_Pin
                           LED_SDO_C_4_Pin LED_SDO_C_5_Pin LED_SDO_C_6_Pin LED_SDO_C_7_Pin
                           LED_SDO_D_0_Pin LED_SDO_D_1_Pin LED_SDO_D_2_Pin LED_SDO_D_3_Pin
                           LED_SDO_D_4_Pin LED_SDO_D_5_Pin LED_SDO_D_6_Pin LED_SDO_D_7_Pin */
  GPIO_InitStruct.Pin = LED_SDO_C_0_Pin|LED_SDO_C_1_Pin|LED_SDO_C_2_Pin|LED_SDO_C_3_Pin
                          |LED_SDO_C_4_Pin|LED_SDO_C_5_Pin|LED_SDO_C_6_Pin|LED_SDO_C_7_Pin
                          |LED_SDO_D_0_Pin|LED_SDO_D_1_Pin|LED_SDO_D_2_Pin|LED_SDO_D_3_Pin
                          |LED_SDO_D_4_Pin|LED_SDO_D_5_Pin|LED_SDO_D_6_Pin|LED_SDO_D_7_Pin;
  GPIO_InitStruct.Mode = GPIO_MODE_OUTPUT_PP;
  GPIO_InitStruct.Pull = GPIO_NOPULL;
  GPIO_InitStruct.Speed = GPIO_SPEED_FREQ_LOW;
  HAL_GPIO_Init(GPIOJ, &GPIO_InitStruct);

  /*Configure GPIO pins : DRV_DIR_D_0_Pin DRV_STP_D_0_Pin DRV_DIR_D_1_Pin DRV_STP_D_1_Pin
                           DRV_DIR_D_2_Pin DRV_STP_D_2_Pin DRV_DIR_D_3_Pin DRV_STP_D_3_Pin
                           DRV_DIR_D_4_Pin DRV_STP_D_4_Pin DRV_DIR_D_5_Pin DRV_STP_D_5_Pin
                           DRV_DIR_D_6_Pin DRV_STP_D_6_Pin DRV_DIR_D_7_Pin DRV_STP_D_7_Pin */
  GPIO_InitStruct.Pin = DRV_DIR_D_0_Pin|DRV_STP_D_0_Pin|DRV_DIR_D_1_Pin|DRV_STP_D_1_Pin
                          |DRV_DIR_D_2_Pin|DRV_STP_D_2_Pin|DRV_DIR_D_3_Pin|DRV_STP_D_3_Pin
                          |DRV_DIR_D_4_Pin|DRV_STP_D_4_Pin|DRV_DIR_D_5_Pin|DRV_STP_D_5_Pin
                          |DRV_DIR_D_6_Pin|DRV_STP_D_6_Pin|DRV_DIR_D_7_Pin|DRV_STP_D_7_Pin;
  GPIO_InitStruct.Mode = GPIO_MODE_OUTPUT_PP;
  GPIO_InitStruct.Pull = GPIO_NOPULL;
  GPIO_InitStruct.Speed = GPIO_SPEED_FREQ_MEDIUM;
  HAL_GPIO_Init(GPIOG, &GPIO_InitStruct);

  /*Configure GPIO pins : DRV_nRESET_A_Pin DRV_nRESET_B_Pin DRV_nRESET_C_Pin DRV_nRESET_D_Pin */
  GPIO_InitStruct.Pin = DRV_nRESET_A_Pin|DRV_nRESET_B_Pin|DRV_nRESET_C_Pin|DRV_nRESET_D_Pin;
  GPIO_InitStruct.Mode = GPIO_MODE_OUTPUT_PP;
  GPIO_InitStruct.Pull = GPIO_PULLDOWN;
  GPIO_InitStruct.Speed = GPIO_SPEED_FREQ_LOW;
  HAL_GPIO_Init(GPIOH, &GPIO_InitStruct);

  /*Configure GPIO pins : DRV_DIR_A_4_Pin DRV_STP_A_4_Pin DRV_DIR_A_5_Pin DRV_STP_A_5_Pin
                           DRV_DIR_A_6_Pin DRV_STP_A_6_Pin DRV_DIR_A_7_Pin DRV_STP_A_7_Pin
                           DRV_DIR_A_0_Pin DRV_STP_A_0_Pin DRV_DIR_A_1_Pin DRV_STP_A_1_Pin
                           DRV_DIR_A_2_Pin DRV_STP_A_2_Pin DRV_DIR_A_3_Pin DRV_STP_A_3_Pin */
  GPIO_InitStruct.Pin = DRV_DIR_A_4_Pin|DRV_STP_A_4_Pin|DRV_DIR_A_5_Pin|DRV_STP_A_5_Pin
                          |DRV_DIR_A_6_Pin|DRV_STP_A_6_Pin|DRV_DIR_A_7_Pin|DRV_STP_A_7_Pin
                          |DRV_DIR_A_0_Pin|DRV_STP_A_0_Pin|DRV_DIR_A_1_Pin|DRV_STP_A_1_Pin
                          |DRV_DIR_A_2_Pin|DRV_STP_A_2_Pin|DRV_DIR_A_3_Pin|DRV_STP_A_3_Pin;
  GPIO_InitStruct.Mode = GPIO_MODE_OUTPUT_PP;
  GPIO_InitStruct.Pull = GPIO_NOPULL;
  GPIO_InitStruct.Speed = GPIO_SPEED_FREQ_MEDIUM;
  HAL_GPIO_Init(GPIOD, &GPIO_InitStruct);

  /*Configure GPIO pins : BRD_ID_0_Pin BRD_ID_1_Pin BRD_ID_2_Pin BRD_ID_3_Pin
                           BRD_ID_4_Pin BRD_ID_5_Pin BRD_ID_6_Pin BRD_ID_7_Pin */
  GPIO_InitStruct.Pin = BRD_ID_0_Pin|BRD_ID_1_Pin|BRD_ID_2_Pin|BRD_ID_3_Pin
                          |BRD_ID_4_Pin|BRD_ID_5_Pin|BRD_ID_6_Pin|BRD_ID_7_Pin;
  GPIO_InitStruct.Mode = GPIO_MODE_INPUT;
  GPIO_InitStruct.Pull = GPIO_PULLUP;
  HAL_GPIO_Init(GPIOK, &GPIO_InitStruct);

  /*Configure GPIO pins : LED_nOE_A_Pin LED_nOE_B_Pin LED_nOE_C_Pin LED_nOE_D_Pin */
  GPIO_InitStruct.Pin = LED_nOE_A_Pin|LED_nOE_B_Pin|LED_nOE_C_Pin|LED_nOE_D_Pin;
  GPIO_InitStruct.Mode = GPIO_MODE_OUTPUT_PP;
  GPIO_InitStruct.Pull = GPIO_PULLUP;
  GPIO_InitStruct.Speed = GPIO_SPEED_FREQ_LOW;
  HAL_GPIO_Init(GPIOC, &GPIO_InitStruct);

  /* EXTI interrupt init*/
  HAL_NVIC_SetPriority(EXTI0_IRQn, 1, 0);
  HAL_NVIC_EnableIRQ(EXTI0_IRQn);

  HAL_NVIC_SetPriority(EXTI15_10_IRQn, 1, 0);
  HAL_NVIC_EnableIRQ(EXTI15_10_IRQn);

}

void _Error_Handler(char *file, int line)
{
  /* USER CODE BEGIN Error_Handler_Debug */
  /* User can add his own implementation to report the HAL error return state */
  printf("ERROR: file %s on line %u\n", file, line);
  while(1)
  {
  }
  /* USER CODE END Error_Handler_Debug */
}

#ifdef  USE_FULL_ASSERT
/**
  * @brief  Reports the name of the source file and the source line number
  *         where the assert_param error has occurred.
  * @param  file: pointer to the source file name
  * @param  line: assert_param error line source number
  * @retval None
  */
void assert_failed(uint8_t* file, uint32_t line)
{
  /* USER CODE BEGIN 6 */
  /* User can add his own implementation to report the file name and line number,
     tex: printf("Wrong parameters value: file %s on line %d\r\n", file, line) */
  printf("Wrong parameters value: file %s on line %lu\n", file, line);
  /* USER CODE END 6 */
}
#endif /* USE_FULL_ASSERT */

/************************ (C) COPYRIGHT STMicroelectronics *****END OF FILE****/
